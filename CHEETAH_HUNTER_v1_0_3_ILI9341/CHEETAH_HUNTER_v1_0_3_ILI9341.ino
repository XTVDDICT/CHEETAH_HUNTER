// CHEETAH HUNTER v1.0.3 Web UI QA build for ILI9341 CYD
// Public/shareable build for ILI9341 screen variant
//
// Features:
// - WiFiManager for first-time WiFi setup / recovery
// - local config page after connected
// - edit wallet + screen flip from browser
// - live CHTA wallet balance with miner-friendly refresh timing
// - cached CHTA/USD/GBP/CAD prices with Gleec/CoinPaprika fallback
// - BLOCK FOUND popup on mined tx or confirmed balance increase
// - background Stratum v1 SHA-256d CPU mining
//
// Required library:
//   WiFiManager by tzapu / tablatronix

#include <WiFi.h>
#include <WiFiClientSecure.h>
#include <HTTPClient.h>
#include <Preferences.h>
#include <LovyanGFX.hpp>
#include <WiFiManager.h>
#include <WebServer.h>
#include "SoloHunterMiner.h"

const char* AP_SSID = "CHEETAH_HUNTER_SETUP";
const char* AP_PASS = "solohunter";

#define TFT_BL 21
#define REAR_LED 17

static const uint32_t WALLET_REFRESH_MS = 300000;
static const uint32_t FIAT_REFRESH_MS   = 600000;
static const uint32_t MINED_ALERT_REFRESH_MS = 120000;
static const uint32_t MINING_DISPLAY_REFRESH_MS = 1000;
static const uint16_t BALANCE_CONNECT_TIMEOUT_MS = 5000;
static const uint16_t BALANCE_HTTP_TIMEOUT_MS    = 10000;
static const uint16_t PRICE_CONNECT_TIMEOUT_MS   = 5000;
static const uint16_t PRICE_HTTP_TIMEOUT_MS      = 10000;

Preferences prefs;
WebServer server(80);

String cfgWallet = "";
String cfgCurrency = "USD";
bool cfgFlip = false;
bool cfgMiningEnabled = false;
String cfgMiningPoolHost = "";
String cfgMiningPoolPort = "3333";
String cfgMiningUser = "";
String cfgMiningWorker = "";
String cfgMiningPass = "x";
const char* PREFS_NS = "chta";

String chainzUrl() {
  // Iquidus-style explorer API for Cheetahcoin balance.
  return String("http://chtaexplorer.mooo.com:3002/ext/getbalance/") + cfgWallet;
}

String coinpaprikaTickerUrl() {
  return String("https://api.coinpaprika.com/v1/tickers/chta-cheetahcoin?quotes=USD,GBP,CAD");
}

String gleecWalletTickersUrl() {
  return String("https://defistats.gleec.com/api/v3/prices/tickers_v2?expire_at=600");
}

String minedTxUrl() {
  // Placeholder: Cheetahcoin public explorer may not expose the same mined-transaction API used by the original build.
  return String("http://chtaexplorer.mooo.com:3002/ext/getaddress/") + cfgWallet;
}

class LGFX : public lgfx::LGFX_Device {
  lgfx::Panel_ILI9341 _panel;
  lgfx::Bus_SPI _bus;
public:
  LGFX(void) {
    {
      auto cfg = _bus.config();
      cfg.spi_host = HSPI_HOST;
      cfg.spi_mode = 0;
      cfg.freq_write = 27000000;
      cfg.freq_read = 16000000;
      cfg.spi_3wire = false;
      cfg.use_lock = true;
      cfg.dma_channel = 1;
      cfg.pin_sclk = 14;
      cfg.pin_mosi = 13;
      cfg.pin_miso = 12;
      cfg.pin_dc   = 2;
      _bus.config(cfg);
      _panel.setBus(&_bus);
    }
    {
      auto cfg = _panel.config();
      cfg.pin_cs = 15;
      cfg.pin_rst = -1;
      cfg.pin_busy = -1;
      cfg.memory_width = 240;
      cfg.memory_height = 320;
      cfg.panel_width = 240;
      cfg.panel_height = 320;
      cfg.offset_x = 0;
      cfg.offset_y = 0;
      cfg.offset_rotation = 0;
      cfg.dummy_read_pixel = 8;
      cfg.dummy_read_bits = 1;
      cfg.readable = true;
      cfg.invert = false;
      cfg.rgb_order = false;
      cfg.dlen_16bit = false;
      cfg.bus_shared = true;
      _panel.config(cfg);
    }
    setPanel(&_panel);
  }
} tft;

static constexpr uint16_t C_BG      = TFT_BLACK;
static constexpr uint16_t C_GREEN   = 0x07E0;
static constexpr uint16_t C_GREEN2  = 0x05A0;
static constexpr uint16_t C_DIM     = 0x7BEF;
static constexpr uint16_t C_WARN    = TFT_YELLOW;
static constexpr uint16_t C_ALERT   = TFT_RED;
static constexpr uint16_t C_POPBG   = 0x0120;

const int IMG_W = 172;
const int IMG_H = 150;
static const uint16_t acceptedImg[IMG_W * IMG_H] PROGMEM = {
  0x0000, 0x0000, 0x0000, 0x0000, 0x0000, 0x0000, 0x0000, 0x0000, 0x0000, 0x0000, 0x0000, 0x0000,
  0x0000, 0x0000, 0x0000, 0x0000, 0x0000, 0x0000, 0x0000, 0x0000, 0x0000, 0x0000, 0x0000, 0x0000,
  0x0000, 0x0000, 0x0000, 0x0000, 0x0000, 0x0000, 0x0000, 0x0000, 0x0000, 0x0000, 0x0000, 0x0000,
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  0x0000, 0x0000, 0x0000, 0x0000, 0x0000, 0x0000, 0x0000, 0x0000, 0x0000, 0x0000, 0x0000, 0x0000
};

float balanceCHTA = 0.0f;
float chtaPriceUsd = 0.0f;
float chtaPriceGbp = 0.0f;
float chtaPriceCad = 0.0f;
float walletFiatValue = 0.0f;
float lastBalanceCHTA = -1.0f;
float deltaCHTA = 0.0f;

bool haveWalletData = false;
bool haveFiatData = false;
bool popupActive = false;
bool popupPersistent = false;
bool portalMode = false;
bool minedBaselineReady = false;

String statusText = "BOOT";
String lastMinedTxId = "";
unsigned long popupUntil = 0;
unsigned long lastWalletFetch = 0;
unsigned long lastFiatFetch = 0;
unsigned long lastMinedAlertCheck = 0;
unsigned long lastMiningDisplayRefresh = 0;
bool pendingWalletRefresh = false;
bool pendingFiatRefresh = false;
unsigned long pendingDataRefreshAt = 0;

float miningHashrateKh = 0.0f;
uint64_t miningTotalHashes = 0;
uint32_t miningSubmittedShares = 0;
uint32_t miningPendingShares = 0;
uint32_t miningAcceptedShares = 0;
uint32_t miningRejectedShares = 0;
uint32_t miningBlocksFound = 0;
uint32_t miningUptimeSeconds = 0;
double miningBestDiff = 0.0;
double miningPoolDifficulty = 0.0;
bool miningHardwareSha = false;
String miningRuntimeStatus = "OFF";

bool isBlockPopupVisible();

void rearLedOn() {
  digitalWrite(REAR_LED, LOW);
}

String fmt2(float v) {
  char buf[24];
  dtostrf(v, 0, 2, buf);
  return String(buf);
}

String fmtDecimals(float v, uint8_t decimals) {
  char buf[24];
  dtostrf(v, 0, decimals, buf);
  return String(buf);
}

String normalizeCurrency(String currency) {
  currency.trim();
  currency.toUpperCase();
  if (currency == "GBP" || currency == "CAD") return currency;
  return "USD";
}

String currentCurrencyCode() {
  return normalizeCurrency(cfgCurrency);
}

String currencyDisplayName(const String& currencyCode) {
  if (currencyCode == "GBP") return "Great British Pound";
  if (currencyCode == "CAD") return "Canadian Dollar";
  return "US Dollar";
}

String currencyPrefix(const String& currencyCode) {
  if (currencyCode == "GBP") return "\xC2\xA3";
  if (currencyCode == "CAD") return "CAD$";
  return "$";
}

String currencyPrefixHtml(const String& currencyCode) {
  if (currencyCode == "GBP") return "&pound;";
  if (currencyCode == "CAD") return "CAD$";
  return "$";
}

float chtaPriceForCurrency(const String& currencyCode) {
  if (currencyCode == "GBP") return chtaPriceGbp;
  if (currencyCode == "CAD") return chtaPriceCad;
  return chtaPriceUsd;
}

float currentChtaFiatPrice() {
  return chtaPriceForCurrency(currentCurrencyCode());
}

float currentWalletFiatValue() {
  float price = currentChtaFiatPrice();
  if (!(haveWalletData && price > 0.0f)) return 0.0f;
  return balanceCHTA * price;
}

void syncFiatAvailability() {
  haveFiatData = (currentChtaFiatPrice() > 0.0f);
}

String currentCurrencyWaitText() {
  return currentCurrencyCode() + " WAIT";
}

String formatFiatAmount(const String& currencyCode, float amount, uint8_t decimals) {
  return currencyPrefix(currencyCode) + fmtDecimals(amount, decimals);
}

String currentFiatAmountText(float amount, uint8_t decimals) {
  return formatFiatAmount(currentCurrencyCode(), amount, decimals);
}

void drawPoundGlyph2x(int x, int y, uint16_t color, uint16_t bg) {
  static const uint8_t poundGlyph[8] = {
    0b001110,
    0b010001,
    0b010000,
    0b111100,
    0b011000,
    0b111100,
    0b010000,
    0b111110
  };

  tft.fillRect(x, y, 12, 16, bg);
  for (int row = 0; row < 8; ++row) {
    for (int col = 0; col < 6; ++col) {
      if (poundGlyph[row] & (1 << (5 - col))) {
        tft.fillRect(x + (col * 2), y + (row * 2), 2, 2, color);
      }
    }
  }
}

String currentCurrencyRetryText() {
  return currentCurrencyCode() + " RETRY";
}

String liveCurrencyWaitStatus() {
  return "LIVE / " + currentCurrencyCode() + " WAIT";
}

float extractJsonFloat(const String& body, const char* key) {
  int pos = body.indexOf(key);
  if (pos < 0) return 0.0f;

  String sub = body.substring(pos + strlen(key));
  int comma = sub.indexOf(",");
  int brace = sub.indexOf("}");
  int end = comma;

  if (end < 0 || (brace >= 0 && brace < end)) end = brace;
  if (end > 0) sub = sub.substring(0, end);
  sub.trim();
  sub.replace("\"", "");
  return sub.toFloat();
}


float extractCoinpaprikaQuotePrice(const String& rawBody, const char* currencyCode) {
  String body = rawBody;
  body.replace("\n", "");
  body.replace("\r", "");
  body.replace("\t", "");
  body.replace(" ", "");
  String key = "\"" + String(currencyCode) + "\":{\"price\":";
  return extractJsonFloat(body, key.c_str());
}

String compactJson(String body) {
  body.replace("\n", "");
  body.replace("\r", "");
  body.replace("\t", "");
  body.replace(" ", "");
  return body;
}

String extractJsonStringValue(const String& body, const char* key) {
  int pos = body.indexOf(key);
  if (pos < 0) return "";
  int start = pos + strlen(key);
  int end = body.indexOf("\"", start);
  if (end < 0 || end <= start) return "";
  return body.substring(start, end);
}

bool extractLatestMinedTx(const String& rawBody, String& txid, float& received) {
  String body = compactJson(rawBody);
  int typePos = body.indexOf("\"type\":\"mined\"");
  if (typePos < 0) return false;

  int objStart = body.lastIndexOf("{", typePos);
  int objEnd = body.indexOf("}", typePos);
  if (objStart < 0 || objEnd < 0 || objEnd <= objStart) return false;

  String obj = body.substring(objStart, objEnd + 1);
  txid = extractJsonStringValue(obj, "\"txid\":\"");
  received = extractJsonStringValue(obj, "\"received\":\"").toFloat();
  if (received <= 0.0f) received = extractJsonFloat(obj, "\"received\":");
  if (received <= 0.0f) received = extractJsonFloat(obj, "\"amount\":");
  if (received <= 0.0f) received = extractJsonFloat(obj, "\"value\":");
  return !txid.isEmpty();
}

String currencyChoiceHtml(const char* code, const char* label, const char* hint) {
  String checked = currentCurrencyCode() == code ? " checked" : "";
  return
    "<label class='choice'>"
      "<input type='radio' name='currency' value='" + String(code) + "'" + checked + ">"
      "<span class='choice-body'>"
        "<span class='choice-code'>" + String(code) + "</span>"
        "<span class='choice-label'>" + String(label) + "</span>"
        "<span class='choice-hint'>" + String(hint) + "</span>"
      "</span>"
    "</label>";
}

void trimConfig() {
  cfgWallet.trim();
  cfgCurrency = normalizeCurrency(cfgCurrency);
  cfgMiningPoolHost.trim();
  cfgMiningPoolPort.trim();
  cfgMiningUser.trim();
  cfgMiningWorker.trim();
  cfgMiningPass.trim();
  if (cfgMiningPoolPort.isEmpty()) cfgMiningPoolPort = "3333";
  if (cfgMiningPass.isEmpty()) cfgMiningPass = "x";
}

void savePrefs() {
  trimConfig();
  prefs.begin(PREFS_NS, false);
  prefs.putString("wallet", cfgWallet);
  prefs.putString("currency", cfgCurrency);
  prefs.putBool("flip", cfgFlip);
  prefs.putBool("mineen", cfgMiningEnabled);
  prefs.putString("poolhost", cfgMiningPoolHost);
  prefs.putString("poolport", cfgMiningPoolPort);
  prefs.putString("mineuser", cfgMiningUser);
  prefs.putString("worker", cfgMiningWorker);
  prefs.putString("minepass", cfgMiningPass);
  prefs.putString("lastmtx", lastMinedTxId);
  prefs.putBool("minebase", minedBaselineReady);
  prefs.putFloat("lastbal", lastBalanceCHTA);
  prefs.putFloat("lastusd", chtaPriceUsd);
  prefs.putFloat("lastgbp", chtaPriceGbp);
  prefs.putFloat("lastcad", chtaPriceCad);
  prefs.end();
}

void loadPrefs() {
  prefs.begin(PREFS_NS, true);
  cfgWallet = prefs.getString("wallet", "");
  cfgCurrency = prefs.getString("currency", "USD");
  cfgFlip = prefs.getBool("flip", false);
  cfgMiningEnabled = prefs.getBool("mineen", false);
  cfgMiningPoolHost = prefs.getString("poolhost", "");
  cfgMiningPoolPort = prefs.getString("poolport", "3333");
  cfgMiningUser = prefs.getString("mineuser", "");
  cfgMiningWorker = prefs.getString("worker", "");
  cfgMiningPass = prefs.getString("minepass", "x");
  lastMinedTxId = prefs.getString("lastmtx", "");
  minedBaselineReady = prefs.getBool("minebase", false);
  lastBalanceCHTA = prefs.getFloat("lastbal", -1.0f);
  chtaPriceUsd = prefs.getFloat("lastusd", 0.0f);
  chtaPriceGbp = prefs.getFloat("lastgbp", 0.0f);
  chtaPriceCad = prefs.getFloat("lastcad", 0.0f);
  prefs.end();
  trimConfig();
  syncFiatAvailability();
}

void saveLastBalance() {
  prefs.begin(PREFS_NS, false);
  prefs.putFloat("lastbal", lastBalanceCHTA);
  prefs.end();
}

void saveMinedAlertState() {
  prefs.begin(PREFS_NS, false);
  prefs.putString("lastmtx", lastMinedTxId);
  prefs.putBool("minebase", minedBaselineReady);
  prefs.end();
}

void saveLastFiatPrices() {
  prefs.begin(PREFS_NS, false);
  prefs.putFloat("lastusd", chtaPriceUsd);
  prefs.putFloat("lastgbp", chtaPriceGbp);
  prefs.putFloat("lastcad", chtaPriceCad);
  prefs.end();
}

void applyRotation() {
  tft.setRotation(cfgFlip ? 3 : 1);
}

String currentIpText() {
  if (WiFi.status() == WL_CONNECTED) return WiFi.localIP().toString();
  return "NO WIFI";
}

String htmlEscape(String s) {
  s.replace("&", "&amp;");
  s.replace("<", "&lt;");
  s.replace(">", "&gt;");
  s.replace("\"", "&quot;");
  return s;
}

String jsonEscape(String s) {
  s.replace("\\", "\\\\");
  s.replace("\"", "\\\"");
  s.replace("\n", "\\n");
  s.replace("\r", "\\r");
  return s;
}

SoloHunterMiningConfig currentMiningEngineConfig() {
  SoloHunterMiningConfig config;
  config.enabled = cfgMiningEnabled;
  config.poolHost = cfgMiningPoolHost;
  long port = cfgMiningPoolPort.toInt();
  config.poolPort = (port > 0 && port <= 65535) ? (uint16_t)port : 3333;
  config.username = cfgMiningUser.isEmpty() ? cfgWallet : cfgMiningUser;
  config.worker = cfgMiningWorker;
  config.password = cfgMiningPass;
  return config;
}

void syncMiningStats() {
  SoloHunterMiningStats stats = soloHunterMinerGetStats();
  miningHashrateKh = stats.hashrateKh;
  miningTotalHashes = stats.totalHashes;
  miningSubmittedShares = stats.submittedShares;
  miningPendingShares = stats.pendingShares;
  miningAcceptedShares = stats.acceptedShares;
  miningRejectedShares = stats.rejectedShares;
  miningBlocksFound = stats.blocksFound;
  miningUptimeSeconds = stats.uptimeSeconds;
  miningBestDiff = stats.bestDifficulty;
  miningPoolDifficulty = stats.poolDifficulty;
  miningHardwareSha = stats.hardwareSha;
  miningRuntimeStatus = stats.status;
}

String formatMiningHashrate() {
  return String((uint32_t)lroundf(miningHashrateKh)) + "KH";
}

String uint64Text(uint64_t value) {
  char text[24];
  snprintf(text, sizeof(text), "%llu", (unsigned long long)value);
  return String(text);
}

String formatMiningTotalHashes() {
  if (miningTotalHashes >= 1000000000ULL) {
    return fmtDecimals((float)miningTotalHashes / 1000000000.0f, 2) + "B";
  }
  if (miningTotalHashes >= 1000000ULL) {
    return fmtDecimals((float)miningTotalHashes / 1000000.0f, 2) + "M";
  }
  if (miningTotalHashes >= 1000ULL) {
    return fmtDecimals((float)miningTotalHashes / 1000.0f, 2) + "K";
  }
  return uint64Text(miningTotalHashes);
}

String formatMiningUptime() {
  uint32_t hours = miningUptimeSeconds / 3600U;
  uint32_t minutes = (miningUptimeSeconds / 60U) % 60U;
  uint32_t seconds = miningUptimeSeconds % 60U;
  char text[24];
  snprintf(text, sizeof(text), "%02lu:%02lu:%02lu",
           (unsigned long)hours, (unsigned long)minutes,
           (unsigned long)seconds);
  return String(text);
}

String formatMiningDiff() {
  if (miningBestDiff >= 1000000.0) return fmtDecimals((float)(miningBestDiff / 1000000.0), 2) + "M";
  if (miningBestDiff >= 1000.0) return fmtDecimals((float)(miningBestDiff / 1000.0), 2) + "K";
  if (miningBestDiff >= 1.0) return fmtDecimals((float)miningBestDiff, 2);
  if (miningBestDiff > 0.0) return fmtDecimals((float)miningBestDiff, 6);
  return fmtDecimals((float)miningBestDiff, 2);
}

String formatMiningDiffCompact() {
  if (miningBestDiff >= 1.0) return formatMiningDiff();
  if (miningBestDiff <= 0.0) return "0.00";
  if (miningBestDiff < 0.0001) return "<.0001";
  return fmtDecimals((float)miningBestDiff, 4);
}

void drawMiningStats() {
  syncMiningStats();
  if (!cfgMiningEnabled) return;

  tft.fillRect(38, 56, 36, 60, C_BG);
  tft.setTextSize(1);
  tft.setTextColor(C_GREEN, C_BG);
  tft.setCursor(38, 58);
  tft.print(formatMiningHashrate());
  tft.setCursor(38, 70);
  tft.print(miningAcceptedShares);
  tft.setCursor(38, 82);
  tft.print(miningRejectedShares);
  tft.setCursor(38, 94);
  tft.print(formatMiningDiffCompact());
  tft.setCursor(38, 106);
  tft.print(miningBlocksFound);
}

void drawBorder() {
  // Semi-thick neon border
  tft.drawRect(0, 0, 320, 240, C_GREEN);
  tft.drawRect(1, 1, 318, 238, C_GREEN);
  tft.drawRect(2, 2, 316, 236, C_GREEN2);
  tft.drawRect(3, 3, 314, 234, C_GREEN2);
}

void drawStaticLayout() {
  tft.fillScreen(C_BG);
  drawBorder();

  tft.setTextColor(C_GREEN, C_BG);
  tft.setTextSize(2);
  const String title = "__CHEETAH_HUNTER__";
  tft.setCursor((tft.width() - tft.textWidth(title)) / 2, 10);
  tft.print(title);

  int imgX = (320 - IMG_W) / 2;
  int imgY = 34;

  tft.setSwapBytes(true);
  tft.pushImage(imgX, imgY, IMG_W, IMG_H, acceptedImg);
  tft.setSwapBytes(false);
  tft.fillRect(6, 50, 68, 70, C_BG);
  if (cfgMiningEnabled) {
    tft.setTextSize(1);
    tft.setTextColor(C_GREEN, C_BG);
    tft.setCursor(8, 58);
    tft.print("HASH");
    tft.setCursor(8, 70);
    tft.print("ACC");
    tft.setCursor(8, 82);
    tft.print("REJ");
    tft.setCursor(8, 94);
    tft.print("BEST");
    tft.setCursor(8, 106);
    tft.print("BLK");
  }
  drawMiningStats();

  tft.drawFastHLine(20, 180, 280, C_GREEN2);
  tft.drawFastHLine(20, 222, 280, C_GREEN2);

  tft.setTextSize(1);
  tft.setTextColor(C_DIM, C_BG);
  tft.setCursor(24, 186);
  tft.print("CHTA BAL");
  String fiatLabel = currentCurrencyCode() + " VALUE";
  int fiatLabelX = 296 - tft.textWidth(fiatLabel);
  if (fiatLabelX < 216) fiatLabelX = 216;
  tft.setCursor(fiatLabelX, 186);
  tft.print(fiatLabel);
  tft.setCursor(24, 226);
  tft.print("STATUS");
}

void drawValues() {
  tft.fillRect(20, 194, 280, 24, C_BG);
  tft.setTextSize(2);
  walletFiatValue = 0.0f;

  if (haveWalletData) {
    tft.setTextColor(C_GREEN, C_BG);
    tft.setCursor(24, 196);
    tft.print(fmt2(balanceCHTA));

    String currencyCode = currentCurrencyCode();
    String fiatText = currentCurrencyWaitText();
    bool drawCustomPound = false;
    String fiatAmountText = "";
    if (haveFiatData) {
      walletFiatValue = currentWalletFiatValue();
      if (currencyCode == "GBP") {
        fiatAmountText = fmt2(walletFiatValue);
        drawCustomPound = true;
      } else {
        fiatText = currentFiatAmountText(walletFiatValue, 2);
      }
      tft.setTextColor(C_GREEN, C_BG);
    } else {
      tft.setTextColor(C_WARN, C_BG);
    }

    if (drawCustomPound) {
      const int poundWidth = 12;
      const int poundGap = 2;
      int amountX = 296 - tft.textWidth(fiatAmountText);
      int poundX = amountX - poundGap - poundWidth;

      if (poundX < 144) {
        poundX = 144;
        amountX = poundX + poundWidth + poundGap;
      }

      drawPoundGlyph2x(poundX, 196, C_GREEN, C_BG);
      tft.setCursor(amountX, 196);
      tft.print(fiatAmountText);
    } else {
      int fiatX = 296 - tft.textWidth(fiatText);
      if (fiatX < 144) fiatX = 144;
      tft.setCursor(fiatX, 196);
      tft.print(fiatText);
    }
  } else {
    if (WiFi.status() == WL_CONNECTED && cfgWallet.isEmpty()) {
      tft.setTextSize(1);
      tft.setTextColor(C_WARN, C_BG);
      tft.setCursor(24, 203);
      tft.print("CONNECT TO ");
      tft.setTextColor(C_GREEN, C_BG);
      tft.print(WiFi.localIP().toString());
    } else {
      tft.setTextColor(C_WARN, C_BG);
      tft.setCursor(24, 196);
      tft.print("NO DATA");
    }
  }

  tft.fillRect(78, 224, 222, 12, C_BG);
  tft.setTextSize(1);
  tft.setTextColor(statusText.startsWith("LIVE") ? C_GREEN : C_ALERT, C_BG);
  tft.setCursor(78, 226);
  tft.print(statusText);
  drawMiningStats();
}

void drawBlockPopup() {
  if (!isBlockPopupVisible()) return;

  int w = 240;
  int h = 90;
  int x = (320 - w) / 2;
  int y = (240 - h) / 2;

  tft.fillRoundRect(x, y, w, h, 12, C_POPBG);
  tft.drawRoundRect(x, y, w, h, 12, C_GREEN);
  tft.drawRoundRect(x + 1, y + 1, w - 2, h - 2, 12, C_GREEN2);

  tft.setTextColor(C_WARN, C_POPBG);
  tft.setTextSize(2);
  tft.setCursor(x + 40, y + 15);
  tft.print("BLOCK FOUND");

  tft.setTextColor(C_GREEN, C_POPBG);
  tft.setTextSize(2);

  String reward = "+" + fmt2(deltaCHTA) + " CHTA";
  int16_t textWidth = reward.length() * 12;
  int textX = x + (w - textWidth) / 2;

  tft.setCursor(textX, y + 50);
  tft.print(reward);
}

void startBlockPopup(float amount) {
  deltaCHTA = amount;
  popupActive = true;
  popupPersistent = true;
  popupUntil = 0;
  drawBlockPopup();
}

bool isBlockPopupVisible() {
  return popupActive && (popupPersistent || millis() < popupUntil);
}

void clearBlockPopup() {
  popupActive = false;
  popupPersistent = false;
  popupUntil = 0;
  drawStaticLayout();
  drawValues();
}


bool fetchChtaBalance() {
  if (WiFi.status() != WL_CONNECTED) {
    statusText = "BAL RETRY";
    return false;
  }

  if (cfgWallet.isEmpty()) {
    statusText = "NO WALLET CONFIG";
    return false;
  }

  SoloHunterMinerHashPause hashPause;
  WiFiClient client;
  HTTPClient http;
  http.setConnectTimeout(BALANCE_CONNECT_TIMEOUT_MS);
  http.setTimeout(BALANCE_HTTP_TIMEOUT_MS);
  http.setUserAgent("ESP32-CHEETAH-HUNTER/1.0.3");

  if (!http.begin(client, chainzUrl())) {
    statusText = "BAL RETRY";
    return false;
  }

  int code = http.GET();
  if (code != 200) {
    statusText = "BAL HTTP " + String(code);
    http.end();
    return false;
  }

  String body = http.getString();
  http.end();
  body.trim();

  if (!body.length() || body.startsWith("ERROR")) {
    statusText = "BAL RETRY";
    return false;
  }

  balanceCHTA = body.toFloat();
  haveWalletData = true;
  return true;
}


bool applyCoinpaprikaFiatPrices(const String& body) {
  bool updated = false;
  float usd = extractCoinpaprikaQuotePrice(body, "USD");
  float gbp = extractCoinpaprikaQuotePrice(body, "GBP");
  float cad = extractCoinpaprikaQuotePrice(body, "CAD");

  if (usd > 0.0f) {
    chtaPriceUsd = usd;
    updated = true;
  }
  if (gbp > 0.0f) {
    chtaPriceGbp = gbp;
    updated = true;
  }
  if (cad > 0.0f) {
    chtaPriceCad = cad;
    updated = true;
  }

  if (!updated) return false;

  saveLastFiatPrices();
  syncFiatAvailability();
  return haveFiatData;
}

bool fetchGleecWalletUsdPrice(float& price) {
  price = 0.0f;

  WiFiClientSecure client;
  client.setInsecure();
  HTTPClient http;
  http.setConnectTimeout(PRICE_CONNECT_TIMEOUT_MS);
  http.setTimeout(PRICE_HTTP_TIMEOUT_MS);
  http.setUserAgent("ESP32-CHEETAH-HUNTER/1.0.3");

  if (!http.begin(client, gleecWalletTickersUrl())) return false;

  int code = http.GET();
  if (code != 200) {
    http.end();
    return false;
  }

  WiFiClient* stream = http.getStreamPtr();
  const char* key = "\"CHTA\":";
  size_t matched = 0;
  bool foundKey = false;
  bool inObject = false;
  int braceDepth = 0;
  String obj;
  obj.reserve(420);

  unsigned long deadline = millis() + PRICE_HTTP_TIMEOUT_MS;
  while (http.connected() && millis() < deadline) {
    while (stream->available()) {
      char c = (char)stream->read();

      if (!foundKey) {
        if (c == key[matched]) {
          matched++;
          if (key[matched] == '\0') foundKey = true;
        } else {
          matched = (c == key[0]) ? 1 : 0;
        }
        continue;
      }

      if (!inObject) {
        if (c == '{') {
          inObject = true;
          braceDepth = 1;
          obj = "{";
        }
        continue;
      }

      obj += c;
      if (c == '{') {
        braceDepth++;
      } else if (c == '}') {
        braceDepth--;
        if (braceDepth == 0) {
          http.end();
          price = extractJsonFloat(obj, "\"last_price\":");
          return price > 0.0f;
        }
      }

      if (obj.length() > 900) {
        http.end();
        return false;
      }
    }
    delay(1);
  }

  http.end();
  return false;
}

void markFiatFetchFailed(const String& detail) {
  syncFiatAvailability();
  if (haveWalletData) {
    statusText = liveCurrencyWaitStatus();
  } else {
    statusText = detail;
  }
}

bool fetchChtaFiatPrices() {
  if (WiFi.status() != WL_CONNECTED) {
    markFiatFetchFailed(currentCurrencyRetryText());
    return false;
  }

  SoloHunterMinerHashPause hashPause;

  float usd = 0.0f;
  if (fetchGleecWalletUsdPrice(usd)) {
    chtaPriceUsd = usd;
    saveLastFiatPrices();
    syncFiatAvailability();
    if (currentCurrencyCode() == "USD") return haveFiatData;
  }

  WiFiClientSecure client;
  client.setInsecure();
  HTTPClient http;
  http.setConnectTimeout(PRICE_CONNECT_TIMEOUT_MS);
  http.setTimeout(PRICE_HTTP_TIMEOUT_MS);
  http.setUserAgent("ESP32-CHEETAH-HUNTER/1.0.3");

  if (!http.begin(client, coinpaprikaTickerUrl())) {
    markFiatFetchFailed(currentCurrencyRetryText());
    return false;
  }

  int code = http.GET();
  if (code != 200) {
    String detail = (code == 429) ? "PRICE RATE LIMIT" : currentCurrencyCode() + " HTTP " + String(code);
    http.end();
    markFiatFetchFailed(detail);
    return false;
  }

  String body = http.getString();
  http.end();

  if (applyCoinpaprikaFiatPrices(body)) return true;

  markFiatFetchFailed(currentCurrencyCode() + " PARSE FAIL");
  return false;
}


bool fetchLatestMinedTx(String& txid, float& received) {
  if (WiFi.status() != WL_CONNECTED || cfgWallet.isEmpty()) return false;

  SoloHunterMinerHashPause hashPause;
  WiFiClient client;
  HTTPClient http;
  http.setConnectTimeout(BALANCE_CONNECT_TIMEOUT_MS);
  http.setTimeout(BALANCE_HTTP_TIMEOUT_MS);
  http.setUserAgent("ESP32-CHEETAH-HUNTER/1.0.3");

  if (!http.begin(client, minedTxUrl())) return false;

  int code = http.GET();
  if (code != 200) {
    http.end();
    return false;
  }

  String body = http.getString();
  http.end();
  return extractLatestMinedTx(body, txid, received);
}

void checkForMinedBlockAlert() {
  if (WiFi.status() != WL_CONNECTED || cfgWallet.isEmpty()) return;

  String txid;
  float received = 0.0f;
  bool foundMinedTx = fetchLatestMinedTx(txid, received);

  if (!minedBaselineReady) {
    if (foundMinedTx) lastMinedTxId = txid;
    minedBaselineReady = true;
    saveMinedAlertState();
    return;
  }

  if (!foundMinedTx || txid.isEmpty() || txid == lastMinedTxId) return;

  lastMinedTxId = txid;
  if (received > 0.0f || !popupActive) {
    startBlockPopup(received);
  }
  saveMinedAlertState();
}

void refreshWalletOnly() {
  bool balOk = fetchChtaBalance();
  if (balOk) {
    statusText = "LIVE " + WiFi.localIP().toString();

    if (lastBalanceCHTA < 0.0f) {
      lastBalanceCHTA = balanceCHTA;
      saveLastBalance();
    } else if (balanceCHTA != lastBalanceCHTA) {
      if (balanceCHTA > lastBalanceCHTA) {
        startBlockPopup(balanceCHTA - lastBalanceCHTA);
      }
      lastBalanceCHTA = balanceCHTA;
      saveLastBalance();
    }
  } else if (haveWalletData) {
    statusText = "LIVE / BAL RETRY";
  }
}

void refreshFiatOnly() {
  if (!haveWalletData || cfgWallet.isEmpty()) return;
  bool fiatOk = fetchChtaFiatPrices();
  if (fiatOk) {
    statusText = "LIVE " + WiFi.localIP().toString();
  } else if (haveWalletData && haveFiatData) {
    statusText = liveCurrencyWaitStatus();
  }
}

bool validPoolPort(const String& portText) {
  if (portText.isEmpty()) return false;
  for (size_t i = 0; i < portText.length(); ++i) {
    if (!isDigit(portText[i])) return false;
  }
  long port = portText.toInt();
  return port > 0 && port <= 65535;
}

void scheduleDataRefresh(bool walletRefresh, bool fiatRefresh) {
  pendingWalletRefresh = pendingWalletRefresh || walletRefresh;
  pendingFiatRefresh = pendingFiatRefresh || fiatRefresh;
  pendingDataRefreshAt = millis() + 2500;
}

void servicePendingDataRefresh() {
  if (!(pendingWalletRefresh || pendingFiatRefresh)) return;
  if ((int32_t)(millis() - pendingDataRefreshAt) < 0) return;

  if (pendingWalletRefresh) {
    pendingWalletRefresh = false;
    refreshWalletOnly();
    lastWalletFetch = millis();
    drawValues();
    pendingDataRefreshAt = millis() + 250;
    return;
  }

  pendingFiatRefresh = false;
  refreshFiatOnly();
  lastFiatFetch = millis();
  drawValues();
}

void sendSaveResult(bool ok, const String& section, const String& message,
                    int statusCode = 200) {
  String json = "{\"ok\":" + String(ok ? "true" : "false") +
                ",\"section\":\"" + jsonEscape(section) +
                "\",\"message\":\"" + jsonEscape(message) + "\"}";
  server.sendHeader("Cache-Control", "no-store");
  server.send(statusCode, "application/json", json);
}

void handleRoot() {
  syncMiningStats();
  String currencyCode = currentCurrencyCode();
  float webChtaPrice = currentChtaFiatPrice();
  uint8_t webPriceDecimals = webChtaPrice < 0.0001f ? 8 : (webChtaPrice < 0.01f ? 6 : 4);
  String walletBalanceText = haveWalletData ? fmt2(balanceCHTA) + " CHTA" : (cfgWallet.isEmpty() ? "Add wallet address" : "Waiting for wallet");
  String walletValueText = haveWalletData && haveFiatData ? currencyPrefixHtml(currencyCode) + fmtDecimals(currentWalletFiatValue(), 2) : (haveWalletData ? currentCurrencyWaitText() : "--");
  String priceText = haveFiatData ? currencyPrefixHtml(currencyCode) + fmtDecimals(webChtaPrice, webPriceDecimals) : currentCurrencyWaitText();
  String screenModeText = cfgFlip ? "Flipped 180" : "Standard";
  String miningStateText = cfgMiningEnabled ? miningRuntimeStatus : "OFF";
  String miningPoolText = cfgMiningPoolHost.isEmpty() ? "No pool configured" : cfgMiningPoolHost + ":" + cfgMiningPoolPort;
  String miningHashrateText = formatMiningHashrate();
  String miningTotalHashesText = formatMiningTotalHashes();
  String miningUptimeText = formatMiningUptime();
  String miningBestText = formatMiningDiffCompact();
  String miningEngineText =
      cfgMiningEnabled ? (miningHardwareSha ? "HW SHA" : "CPU FALLBACK") : "OFF";
  String savedSection = server.hasArg("saved") ? server.arg("saved") : "";
  String savedMessage = savedSection == "mining"
    ? "Mining settings saved. Reconnecting to the pool."
    : (savedSection == "display" ? "Display settings saved." : "");

  String page;
  page.reserve(18000);
  page += "<!doctype html><html><head><meta name='viewport' content='width=device-width,initial-scale=1'>";
  page += "<title>CHEETAH HUNTER v1.0.3 Control Panel</title>";
  page += "<style>";
  page += ":root{--bg:#07100a;--surface:#101a13;--surface-2:#0b140e;--line:#294433;--line-strong:#3a6047;--accent:#62ff9b;--accent-strong:#1cc86d;--text:#edf7f0;--muted:#9db5a5;--warn:#f4c95d;--error:#ff7b72;--info:#73b7ff}";
  page += "*{box-sizing:border-box;letter-spacing:0}body{margin:0;min-height:100vh;padding:20px;color:var(--text);font-family:'Segoe UI','Trebuchet MS',sans-serif;background:var(--bg)}";
  page += ".shell{width:min(1120px,100%);margin:0 auto;display:grid;gap:16px}.panel{background:var(--surface);border:1px solid var(--line);border-radius:8px;padding:20px}.hero.panel{display:grid;grid-template-columns:1fr auto;align-items:end;gap:20px;padding:8px 0 16px;background:transparent;border:0;border-bottom:1px solid var(--line);border-radius:0}";
  page += ".eyebrow{font-size:12px;font-weight:700;color:var(--accent)}h1{margin:5px 0 4px;font-size:30px;line-height:1.1}.hero-copy,.section-head p,.action-panel p{margin:0;color:var(--muted);font-size:14px;line-height:1.5}";
  page += ".chip-row{display:flex;justify-content:flex-end;flex-wrap:wrap;gap:8px;margin:0}.pill{display:inline-flex;align-items:center;min-height:34px;padding:7px 10px;border-radius:6px;background:var(--surface-2);border:1px solid var(--line);color:#dff7e6;font-size:13px;font-weight:600}";
  page += ".tabs.panel{padding:0;background:transparent;border:0}.tabs{display:grid;gap:16px}.tabbar{display:flex;gap:4px;padding:4px;background:var(--surface-2);border:1px solid var(--line);border-radius:8px}.tab-button{min-width:120px;background:transparent;color:var(--muted);border:0;box-shadow:none}.tab-button.active{background:var(--surface);color:var(--accent);box-shadow:inset 0 -2px 0 var(--accent)}.tab-pane{display:none}.tab-pane.active{display:block}";
  page += ".layout{display:grid;grid-template-columns:minmax(0,1.08fr) minmax(320px,.92fr);gap:16px}.section-head{display:flex;justify-content:space-between;align-items:flex-start;gap:12px;margin-bottom:16px}.section-head h2,.action-panel h2{margin:0 0 4px;font-size:19px}.section-pills{display:flex;justify-content:flex-end;gap:8px;flex-wrap:wrap}";
  page += ".stats{display:grid;grid-template-columns:repeat(2,minmax(0,1fr));gap:10px}.stat{min-height:124px;padding:14px;border-radius:6px;background:var(--surface-2);border:1px solid var(--line)}.mining-stats .stat{min-height:108px}.mining-stats .stat strong{font-size:21px}.stat-label{display:block;font-size:11px;font-weight:700;color:var(--muted);margin-bottom:9px}.stat strong{display:block;font-size:27px;line-height:1.15;margin-bottom:7px;overflow-wrap:anywhere}.stat small{color:var(--muted);font-size:12px;line-height:1.4}";
  page += ".miner-meta{display:grid;grid-template-columns:repeat(2,minmax(0,1fr));gap:10px;margin-top:10px}.miner-meta div{padding:11px 12px;background:var(--surface-2);border:1px solid var(--line);border-radius:6px}.miner-meta span{display:block;color:var(--muted);font-size:11px;font-weight:700}.miner-meta strong{display:block;margin-top:5px;font-size:14px;overflow-wrap:anywhere}";
  page += ".field-grid{display:grid;grid-template-columns:repeat(2,minmax(0,1fr));gap:13px}.full{grid-column:1/-1}.field-label{display:block;font-size:12px;font-weight:700;color:var(--muted);margin-bottom:7px}input{width:100%;min-height:46px;padding:11px 12px;border-radius:6px;border:1px solid var(--line-strong);background:var(--surface-2);color:var(--text);font-size:15px;outline:none}";
  page += "input:focus{border-color:var(--accent);box-shadow:0 0 0 3px rgba(98,255,155,.12)}input:invalid{border-color:var(--error)}.choices{display:grid;grid-template-columns:repeat(3,minmax(0,1fr));gap:8px;margin-bottom:16px}.choice{display:block;position:relative;cursor:pointer}.choice input{position:absolute;opacity:0;pointer-events:none}.choice-body{display:block;min-height:116px;padding:13px;border-radius:6px;border:1px solid var(--line-strong);background:var(--surface-2)}";
  page += ".choice input:checked + .choice-body{border-color:var(--accent);box-shadow:inset 0 0 0 1px var(--accent)}.choice-code{display:block;font-size:18px;font-weight:700;margin-bottom:7px}.choice-label{display:block;font-size:13px;font-weight:700;margin-bottom:5px}.choice-hint{display:block;font-size:11px;color:var(--muted);line-height:1.4}.toggle-row{display:grid;gap:10px;margin:16px 0}.toggle{display:flex;align-items:center;gap:10px;padding:12px;border-radius:6px;background:var(--surface-2);border:1px solid var(--line)}.toggle input{width:18px;height:18px;min-height:18px;accent-color:var(--accent-strong);margin:0}";
  page += ".actions{display:flex;gap:10px;flex-wrap:wrap}button{appearance:none;min-height:42px;border:1px solid transparent;border-radius:6px;padding:10px 15px;font-weight:700;font-size:14px;cursor:pointer}button:focus-visible{outline:3px solid rgba(98,255,155,.3);outline-offset:2px}button:disabled{cursor:wait;opacity:.65}.primary{background:var(--accent-strong);color:#031108}.primary:hover{background:var(--accent)}.secondary{background:var(--surface-2);color:var(--text);border-color:var(--line-strong)}.secondary:hover{border-color:var(--accent)}";
  page += ".action-panel{display:flex;justify-content:space-between;align-items:center;gap:16px}.notice{position:sticky;top:10px;z-index:10;display:flex;align-items:center;min-height:46px;padding:11px 14px;border:1px solid var(--line);border-radius:6px;background:var(--surface);font-size:14px;font-weight:700}.notice[hidden]{display:none}.notice.busy{border-color:var(--info);color:#dcecff}.notice.success{border-color:var(--accent-strong);color:#dfffea}.notice.error{border-color:var(--error);color:#ffd9d6}";
  page += "@media (max-width:900px){body{padding:14px}.hero.panel{grid-template-columns:1fr;align-items:start}.chip-row{justify-content:flex-start}.layout,.field-grid{grid-template-columns:1fr}.tab-button{flex:1;min-width:0}.action-panel{align-items:flex-start}}@media (max-width:560px){body{padding:10px}.panel{padding:14px}.stats,.choices,.mining-stats,.miner-meta{grid-template-columns:1fr}.stat{min-height:0}.choice-body{min-height:0}.actions button{width:100%}.pill{max-width:100%;overflow-wrap:anywhere}}";
  page += "</style></head><body><main class='shell'>";
  page += "<section class='hero panel'><div><div class='eyebrow'>v1.0.3 CONTROL PANEL</div>";
  page += "<h1>CHEETAH HUNTER</h1><p class='hero-copy'>Cheetahcoin wallet display and SHA-256 miner</p></div>";
  page += "<div class='chip-row'>";
  page += "<span class='pill' id='ci'>IP: " + htmlEscape(currentIpText()) + "</span>";
  page += "<span class='pill' id='cs'>Status: " + htmlEscape(statusText) + "</span>";
  page += "<span class='pill' id='cc'>Currency: " + htmlEscape(currencyCode) + " | " + htmlEscape(currencyDisplayName(currencyCode)) + "</span>";
  page += "</div></section>";
  page += "<section class='panel tabs'><div class='tabbar'>";
  page += "<button class='tab-button active' type='button' data-tab='display'>Display</button>";
  page += "<button class='tab-button' type='button' data-tab='mining'>Mining</button>";
  page += "</div>";
  page += "<div id='saveNotice' class='notice success' role='status' aria-live='polite'" + String(savedMessage.isEmpty() ? " hidden" : "") + ">" + htmlEscape(savedMessage) + "</div>";
  page += "<div id='tab-display' class='tab-pane active'><section class='layout'>";
  page += "<div class='panel'><div class='section-head'><div><h2>Live Dashboard</h2><p>Selected currency drives both the screen value and the live browser stats below.</p></div><span class='pill'>" + htmlEscape(currencyDisplayName(currencyCode)) + "</span></div>";
  page += "<div class='stats'>";
  page += "<article class='stat'><span class='stat-label'>Wallet Balance</span><strong id='bd'>" + htmlEscape(walletBalanceText) + "</strong><small>Current Cheetahcoin balance from the CHTA explorer.</small></article>";
  page += "<article class='stat'><span class='stat-label'>Wallet Value</span><strong id='wf'>" + walletValueText + "</strong><small>The value currently shown on the device.</small></article>";
  page += "<article class='stat'><span class='stat-label'>CHTA Price</span><strong id='pf'>" + priceText + "</strong><small>Uses Gleec when CHTA is present; otherwise CoinPaprika USD/GBP/CAD.</small></article>";
  page += "<article class='stat'><span class='stat-label'>Screen Mode</span><strong id='sm'>" + htmlEscape(screenModeText) + "</strong><small>Current display orientation.</small></article>";
  page += "</div></div>";
  page += "<div class='panel'><div class='section-head'><div><h2>Device Settings</h2><p>Everything important is on one page so the device is easier to configure and check at a glance.</p></div></div>";
  page += "<form class='settings-form' data-section='display' method='POST' action='/save' autocomplete='off'>";
  page += "<input type='hidden' name='section' value='display'>";
  page += "<label class='field-label' for='wallet'>CHTA Wallet Address</label>";
  page += "<input id='wallet' name='wallet' value='" + htmlEscape(cfgWallet) + "' placeholder='Enter your Cheetahcoin wallet address' spellcheck='false' autocapitalize='none'>";
  page += "<div class='field-label'>Display Currency</div>";
  page += "<div class='choices'>";
  page += currencyChoiceHtml("USD", "US Dollar", "Standard US dollar wallet value");
  page += currencyChoiceHtml("GBP", "Great British Pound", "British pound wallet value");
  page += currencyChoiceHtml("CAD", "Canadian Dollar", "Canadian dollar wallet value");
  page += "</div>";
  page += "<div class='toggle-row'>";
  page += "<label class='toggle'><input type='checkbox' name='flip' " + String(cfgFlip ? "checked" : "") + "><span>Flip screen 180&deg;</span></label>";
  page += "</div>";
  page += "<div class='actions'><button class='primary' type='submit' data-idle-label='Save Settings'>Save Settings</button></div>";
  page += "</form></div></section></div>";
  page += "<div id='tab-mining' class='tab-pane'>";
  page += "<section class='layout'>";
  page += "<div class='panel'><div class='section-head'><div><h2>Mining Dashboard</h2><p>Live SHA-256 mining data.</p></div><div class='section-pills'><span class='pill' id='ms0'>" + htmlEscape(miningStateText) + "</span><span class='pill' id='mp0'>" + htmlEscape(miningPoolText) + "</span></div></div>";
  page += "<div class='stats mining-stats'>";
  page += "<article class='stat'><span class='stat-label'>Hashrate</span><strong id='mh'>" + htmlEscape(miningHashrateText) + "</strong><small>Current SHA-256 hashing speed.</small></article>";
  page += "<article class='stat'><span class='stat-label'>Hash Engine</span><strong id='me'>" + htmlEscape(miningEngineText) + "</strong></article>";
  page += "<article class='stat'><span class='stat-label'>Session Hashes</span><strong id='mt'>" + htmlEscape(miningTotalHashesText) + "</strong></article>";
  page += "<article class='stat'><span class='stat-label'>Session Uptime</span><strong id='mu'>" + htmlEscape(miningUptimeText) + "</strong></article>";
  page += "<article class='stat'><span class='stat-label'>Accepted Shares</span><strong id='ma'>" + String(miningAcceptedShares) + "</strong></article>";
  page += "<article class='stat'><span class='stat-label'>Rejected Shares</span><strong id='mr'>" + String(miningRejectedShares) + "</strong></article>";
  page += "<article class='stat'><span class='stat-label'>Submitted Shares</span><strong id='ms'>" + String(miningSubmittedShares) + "</strong></article>";
  page += "<article class='stat'><span class='stat-label'>Pending Shares</span><strong id='mp'>" + String(miningPendingShares) + "</strong></article>";
  page += "<article class='stat'><span class='stat-label'>Blocks Found</span><strong id='mb'>" + String(miningBlocksFound) + "</strong><small>Network-target hashes this run.</small></article>";
  page += "<article class='stat'><span class='stat-label'>Best Difficulty</span><strong id='md'>" + htmlEscape(miningBestText) + "</strong></article>";
  page += "<article class='stat'><span class='stat-label'>Pool Difficulty</span><strong id='mpd'>" + htmlEscape(fmtDecimals((float)miningPoolDifficulty, 4)) + "</strong></article>";
  page += "</div><div class='miner-meta'><div><span>Worker</span><strong id='mw'>" + htmlEscape(cfgMiningWorker.isEmpty() ? "--" : cfgMiningWorker) + "</strong></div><div><span>Firmware</span><strong id='mv'>v1.0.3 / CHTA-HW-SHA-1</strong></div></div></div>";
  page += "<div class='panel'><div class='section-head'><div><h2>Mining Settings</h2><p>Pool login for CHTA SHA-256 mining mode.</p></div></div>";
  page += "<form class='settings-form' data-section='mining' method='POST' action='/save' autocomplete='off'>";
  page += "<input type='hidden' name='section' value='mining'>";
  page += "<div class='toggle-row'>";
  page += "<label class='toggle'><input id='miningEnabled' type='checkbox' name='mining_enabled' " + String(cfgMiningEnabled ? "checked" : "") + "><span>Enable SHA-256 mining mode</span></label>";
  page += "</div>";
  page += "<div class='field-grid'>";
  page += "<div><label class='field-label' for='mine_host'>Pool Host</label><input id='mine_host' name='mine_host' value='" + htmlEscape(cfgMiningPoolHost) + "' placeholder='sha256.pool.example' spellcheck='false' autocapitalize='none'></div>";
  page += "<div><label class='field-label' for='mine_port'>Pool Port</label><input id='mine_port' name='mine_port' type='number' inputmode='numeric' min='1' max='65535' value='" + htmlEscape(cfgMiningPoolPort) + "' placeholder='3333'></div>";
  page += "<div class='full'><label class='field-label' for='mine_user'>Wallet / Username</label><input id='mine_user' name='mine_user' value='" + htmlEscape(cfgMiningUser) + "' placeholder='CHTA wallet address or pool username' spellcheck='false' autocapitalize='none'></div>";
  page += "<div><label class='field-label' for='mine_worker'>Worker Name</label><input id='mine_worker' name='mine_worker' value='" + htmlEscape(cfgMiningWorker) + "' placeholder='cheetah-hunter-01' spellcheck='false' autocapitalize='none'></div>";
  page += "<div><label class='field-label' for='mine_pass'>Pool Password</label><input id='mine_pass' name='mine_pass' value='" + htmlEscape(cfgMiningPass) + "' placeholder='x' spellcheck='false' autocapitalize='none'></div>";
  page += "</div>";
  page += "<div class='actions' style='margin-top:18px'><button class='primary' type='submit' data-idle-label='Save Mining Settings'>Save Mining Settings</button></div>";
  page += "</form></div></section></div></section>";
  page += "<section class='panel action-panel'><div><h2>Block Alert</h2><p>Dismiss the current block-found message on the device.</p></div>";
  page += "<form method='POST' action='/clear-popup'><button class='secondary' type='submit'>Clear BLOCK FOUND notification</button></form></section>";
  page += "<section class='panel action-panel'><div><h2>WiFi Setup</h2><p>Reopen the WiFi setup portal.</p></div>";
  page += "<form method='POST' action='/wifi'><button class='secondary' type='submit'>Open WiFi Setup</button></form></section>";
  page += "<script>";
  page += "const el=id=>document.getElementById(id);const notice=el('saveNotice');let noticeTimer=0,statusBusy=false;";
  page += "const showTab=name=>{document.querySelectorAll('.tab-button').forEach(b=>b.classList.toggle('active',b.dataset.tab===name));document.querySelectorAll('.tab-pane').forEach(p=>p.classList.toggle('active',p.id==='tab-'+name));};";
  page += "const setTab=name=>{showTab(name);history.replaceState(null,'','#'+name);};document.querySelectorAll('.tab-button').forEach(b=>b.addEventListener('click',()=>setTab(b.dataset.tab)));showTab(location.hash==='#mining'?'mining':'display');";
  page += "const showNotice=(message,state,hold=false)=>{clearTimeout(noticeTimer);notice.textContent=message;notice.className='notice '+state;notice.hidden=false;if(!hold&&state==='success')noticeTimer=setTimeout(()=>notice.hidden=true,6500);};";
  page += "if(location.search){history.replaceState(null,'',location.pathname+location.hash);}if(!notice.hidden)noticeTimer=setTimeout(()=>notice.hidden=true,6500);";
  page += "const miningEnabled=el('miningEnabled');const syncMiningRequired=()=>{const on=miningEnabled.checked;el('mine_host').required=on;el('mine_port').required=on;el('mine_user').required=on&&!el('wallet').value.trim();};miningEnabled.addEventListener('change',syncMiningRequired);el('wallet').addEventListener('input',syncMiningRequired);syncMiningRequired();";
  page += "document.querySelectorAll('.settings-form').forEach(form=>form.addEventListener('submit',async event=>{event.preventDefault();syncMiningRequired();if(!form.reportValidity())return;const button=form.querySelector('button[type=submit]');const idle=button.dataset.idleLabel||button.textContent;button.disabled=true;button.textContent='Saving...';showNotice('Saving settings...','busy',true);const body=new URLSearchParams();new FormData(form).forEach((value,key)=>body.append(key,value));body.set('response','json');try{const res=await fetch('/save',{method:'POST',headers:{'Content-Type':'application/x-www-form-urlencoded','Accept':'application/json'},body:body.toString(),cache:'no-store'});let data={};try{data=await res.json();}catch(e){}if(!res.ok||!data.ok)throw new Error(data.message||'The device could not save these settings.');showNotice(data.message||'Settings saved.','success');if(form.dataset.section==='mining')showTab('mining');setTimeout(refreshStatus,350);}catch(error){showNotice(error.message||'Save failed. Check the connection and try again.','error',true);}finally{button.disabled=false;button.textContent=idle;}}));";
  page += "const fmt=(n,d=2)=>Number.isFinite(n)?n.toFixed(d):'--';const priceFmt=n=>Number.isFinite(n)?n.toFixed(n<.0001?8:(n<.01?6:4)):'--';const prefix=c=>c==='GBP'?'\\u00A3':(c==='CAD'?'CAD$':'$');const hashFmt=n=>Number.isFinite(n)?Math.round(n)+' KH/s':'--';const countFmt=n=>Number.isFinite(n)?(n>=1e9?(n/1e9).toFixed(2)+'B':(n>=1e6?(n/1e6).toFixed(2)+'M':(n>=1e3?(n/1e3).toFixed(2)+'K':Math.round(n)))):'--';";
  page += "const uptimeFmt=n=>{n=Math.max(0,Math.floor(Number(n)||0));const h=Math.floor(n/3600),m=Math.floor(n/60)%60,s=n%60;return [h,m,s].map(v=>String(v).padStart(2,'0')).join(':');};const diffFmt=n=>Number.isFinite(n)?(n>=1000000?(n/1000000).toFixed(2)+'M':(n>=1000?(n/1000).toFixed(2)+'K':(n>=1?n.toFixed(2):(n>=0.0001?n.toFixed(4):(n>0?'<0.0001':'0.00'))))):'--';";
  page += "async function refreshStatus(){if(statusBusy)return;statusBusy=true;const controller=new AbortController(),timer=setTimeout(()=>controller.abort(),4000);try{const res=await fetch('/status',{cache:'no-store',signal:controller.signal});if(!res.ok)return;const s=await res.json();el('ci').textContent='IP: '+(s.ip||'NO WIFI');el('cs').textContent='Status: '+(s.status||'BOOT');el('cc').textContent='Currency: '+(s.currency||'USD')+' | '+(s.currency_name||'US Dollar');el('bd').textContent=s.have_wallet_data?fmt(s.balance_chta)+' CHTA':(s.wallet_configured?'Waiting for wallet':'Add wallet address');el('wf').textContent=s.have_wallet_data&&s.have_fiat_data?(prefix(s.currency)+fmt(s.wallet_fiat)):((s.currency||'USD')+' WAIT');el('pf').textContent=s.have_fiat_data?(prefix(s.currency)+priceFmt(s.chta_fiat)):((s.currency||'USD')+' WAIT');el('sm').textContent=s.flip?'Flipped 180':'Standard';el('ms0').textContent=s.mining_enabled?(s.mining_status||'STARTING'):'OFF';el('mp0').textContent=s.mining_pool?(s.mining_pool+':'+s.mining_pool_port):'No pool configured';el('mh').textContent=hashFmt(s.mining_hashrate_kh);el('me').textContent=s.mining_enabled?(s.mining_engine||'CPU FALLBACK'):'OFF';el('mt').textContent=countFmt(s.mining_total_hashes);el('mu').textContent=uptimeFmt(s.mining_uptime_seconds);el('ma').textContent=s.mining_accepted_shares||0;el('mr').textContent=s.mining_rejected_shares||0;el('ms').textContent=s.mining_submitted_shares||0;el('mp').textContent=s.mining_pending_shares||0;el('mb').textContent=s.mining_blocks_found||0;el('md').textContent=diffFmt(s.mining_best_diff);el('mpd').textContent=diffFmt(s.mining_pool_difficulty);el('mw').textContent=s.mining_worker||'--';el('mv').textContent='v'+(s.firmware_version||'1.0.3')+' / '+(s.mining_build||'CHTA-HW-SHA-1');}catch(e){}finally{clearTimeout(timer);statusBusy=false;}}refreshStatus();setInterval(refreshStatus,1200);";
  page += "</script></main></body></html>";
  server.send(200, "text/html", page);
}

void handleSave() {
  String saveSection = server.hasArg("section") ? server.arg("section") : "display";
  bool wantsJson = server.hasArg("response") && server.arg("response") == "json";
  bool displaySave = (saveSection != "mining");

  if (displaySave) {
    String newWallet = server.hasArg("wallet") ? server.arg("wallet") : cfgWallet;
    String newCurrency = server.hasArg("currency") ? server.arg("currency") : cfgCurrency;
    newWallet.trim();
    newCurrency = normalizeCurrency(newCurrency);
    bool newFlip = server.hasArg("flip");
    bool walletChanged = (newWallet != cfgWallet);
    bool currencyChanged = (newCurrency != currentCurrencyCode());

    cfgWallet = newWallet;
    cfgCurrency = newCurrency;
    cfgFlip = newFlip;

    if (walletChanged) {
      haveWalletData = false;
      popupActive = false;
      popupPersistent = false;
      popupUntil = 0;
      deltaCHTA = 0.0f;
      lastBalanceCHTA = -1.0f;
      lastMinedTxId = "";
      minedBaselineReady = false;
      lastMinedAlertCheck = millis();
    }

    syncFiatAvailability();
    savePrefs();

    String message = "Display settings saved.";
    if (walletChanged && !cfgWallet.isEmpty()) {
      message = "Display settings saved. Wallet data is refreshing in the background.";
    } else if (currencyChanged && !cfgWallet.isEmpty()) {
      message = "Display settings saved. Currency data is refreshing in the background.";
    }

    if (wantsJson) {
      sendSaveResult(true, "display", message);
    } else {
      server.sendHeader("Location", "/?saved=display", true);
      server.send(303, "text/plain", "");
    }

    applyRotation();
    drawStaticLayout();
    drawValues();

    if (WiFi.status() == WL_CONNECTED && !cfgWallet.isEmpty()) {
      scheduleDataRefresh(walletChanged, walletChanged || currencyChanged);
    }
    return;
  }

  bool newMiningEnabled = server.hasArg("mining_enabled");
  String newPoolHost = server.hasArg("mine_host") ? server.arg("mine_host") : cfgMiningPoolHost;
  String newPoolPort = server.hasArg("mine_port") ? server.arg("mine_port") : cfgMiningPoolPort;
  String newMiningUser = server.hasArg("mine_user") ? server.arg("mine_user") : cfgMiningUser;
  String newMiningWorker = server.hasArg("mine_worker") ? server.arg("mine_worker") : cfgMiningWorker;
  String newMiningPass = server.hasArg("mine_pass") ? server.arg("mine_pass") : cfgMiningPass;
  newPoolHost.trim();
  newPoolPort.trim();
  newMiningUser.trim();
  newMiningWorker.trim();
  newMiningPass.trim();
  if (newPoolPort.isEmpty()) newPoolPort = "3333";
  if (newMiningPass.isEmpty()) newMiningPass = "x";

  if (newMiningEnabled && newPoolHost.isEmpty()) {
    sendSaveResult(false, "mining", "Enter a pool host before enabling mining.", 400);
    return;
  }
  if (newMiningEnabled && !validPoolPort(newPoolPort)) {
    sendSaveResult(false, "mining", "Pool port must be a number from 1 to 65535.", 400);
    return;
  }
  if (newMiningEnabled && newMiningUser.isEmpty() && cfgWallet.isEmpty()) {
    sendSaveResult(false, "mining", "Enter a wallet or pool username before enabling mining.", 400);
    return;
  }

  cfgMiningEnabled = newMiningEnabled;
  cfgMiningPoolHost = newPoolHost;
  cfgMiningPoolPort = newPoolPort;
  cfgMiningUser = newMiningUser;
  cfgMiningWorker = newMiningWorker;
  cfgMiningPass = newMiningPass;
  savePrefs();

  String message = cfgMiningEnabled
    ? "Mining settings saved. Reconnecting to the pool."
    : "Mining settings saved. Mining is turned off.";
  if (wantsJson) {
    sendSaveResult(true, "mining", message);
  } else {
    server.sendHeader("Location", "/?saved=mining#mining", true);
    server.send(303, "text/plain", "");
  }

  soloHunterMinerConfigure(currentMiningEngineConfig());
  drawStaticLayout();
  drawValues();
}

void handleSaveGet() {
  server.sendHeader("Location", "/", true);
  server.send(303, "text/plain", "");
}

void handleOpenWifiPortal() {
  portalMode = true;
  server.send(200, "text/html",
    "<!doctype html><html><head><meta name='viewport' content='width=device-width,initial-scale=1'>"
    "<title>WiFi Setup Requested</title>"
    "<style>body{margin:0;min-height:100vh;display:grid;place-items:center;background:#08100a;color:#edf7f0;font-family:'Trebuchet MS','Segoe UI',sans-serif;padding:20px}"
    ".card{max-width:520px;padding:24px;border-radius:8px;background:#101a13;border:1px solid #294433;box-shadow:0 18px 48px rgba(0,0,0,.32)}"
    "h2{margin:0 0 10px;color:#62ff9b}p{margin:0;color:#9db5a5;line-height:1.6}</style></head><body><div class='card'>"
    "<h2>WiFi portal requested.</h2><p>The device is switching into setup mode now. Connect to the CHEETAH_HUNTER_SETUP network if prompted.</p>"
    "</div></body></html>");
}

void handleClearPopup() {
  clearBlockPopup();
  server.sendHeader("Location", "/", true);
  server.send(303, "text/plain", "");
}

void handleStatusJson() {
  syncFiatAvailability();
  syncMiningStats();
  walletFiatValue = currentWalletFiatValue();
  String currencyCode = currentCurrencyCode();
  String json = "{";
  json += "\"ip\":\"" + jsonEscape(currentIpText()) + "\",";
  json += "\"status\":\"" + jsonEscape(statusText) + "\",";
  json += "\"currency\":\"" + jsonEscape(currencyCode) + "\",";
  json += "\"currency_name\":\"" + jsonEscape(currencyDisplayName(currencyCode)) + "\",";
  json += "\"balance_chta\":" + String(balanceCHTA, 8) + ",";
  json += "\"chta_usd\":" + String(chtaPriceUsd, 8) + ",";
  json += "\"chta_gbp\":" + String(chtaPriceGbp, 8) + ",";
  json += "\"chta_cad\":" + String(chtaPriceCad, 8) + ",";
  json += "\"chta_fiat\":" + String(currentChtaFiatPrice(), 8) + ",";
  json += "\"price_source\":\"gleec_wallet_tickers_v2_or_coinpaprika\",";
  json += "\"wallet_fiat\":" + String(walletFiatValue, 8) + ",";
  json += "\"wallet_usd\":" + String(balanceCHTA * chtaPriceUsd, 8) + ",";
  json += "\"wallet_configured\":" + String(cfgWallet.isEmpty() ? "false" : "true") + ",";
  json += "\"have_wallet_data\":" + String(haveWalletData ? "true" : "false") + ",";
  json += "\"have_fiat_data\":" + String(haveFiatData ? "true" : "false") + ",";
  json += "\"mining_enabled\":" + String(cfgMiningEnabled ? "true" : "false") + ",";
  json += "\"mining_status\":\"" + jsonEscape(miningRuntimeStatus) + "\",";
  json += "\"mining_pool\":\"" + jsonEscape(cfgMiningPoolHost) + "\",";
  json += "\"mining_pool_port\":" + cfgMiningPoolPort + ",";
  json += "\"mining_worker\":\"" + jsonEscape(cfgMiningWorker) + "\",";
  json += "\"mining_engine\":\"" + String(cfgMiningEnabled ? (miningHardwareSha ? "HW SHA" : "CPU FALLBACK") : "OFF") + "\",";
  json += "\"mining_hashrate_kh\":" + String(miningHashrateKh, 3) + ",";
  json += "\"mining_total_hashes\":" + uint64Text(miningTotalHashes) + ",";
  json += "\"mining_submitted_shares\":" + String(miningSubmittedShares) + ",";
  json += "\"mining_pending_shares\":" + String(miningPendingShares) + ",";
  json += "\"mining_accepted_shares\":" + String(miningAcceptedShares) + ",";
  json += "\"mining_rejected_shares\":" + String(miningRejectedShares) + ",";
  json += "\"mining_blocks_found\":" + String(miningBlocksFound) + ",";
  json += "\"mining_uptime_seconds\":" + String(miningUptimeSeconds) + ",";
  json += "\"mining_best_diff\":" + String(miningBestDiff, 4) + ",";
  json += "\"mining_pool_difficulty\":" + String(miningPoolDifficulty, 6) + ",";
  json += "\"refresh_pending\":" + String((pendingWalletRefresh || pendingFiatRefresh) ? "true" : "false") + ",";
  json += "\"firmware_version\":\"1.0.3\",";
  json += "\"mining_build\":\"CHTA-HW-SHA-1\",";
  json += "\"flip\":" + String(cfgFlip ? "true" : "false");
  json += "}";
  server.send(200, "application/json", json);
}

void setupWebServer() {
  server.on("/", HTTP_GET, handleRoot);
  server.on("/save", HTTP_POST, handleSave);
  server.on("/save", HTTP_GET, handleSaveGet);
  server.on("/clear-popup", HTTP_POST, handleClearPopup);
  server.on("/wifi", HTTP_POST, handleOpenWifiPortal);
  server.on("/status", HTTP_GET, handleStatusJson);
  server.begin();
}

void runWifiManagerPortal() {
  WiFiManager wm;
  portalMode = true;
  drawStaticLayout();
  statusText = "CONNECT TO CHEETAH_HUNTER_SETUP WIFI";
  drawValues();
  wm.setConfigPortalTimeout(180);
  bool connected = wm.autoConnect(AP_SSID, AP_PASS);

  if (!connected) {
    statusText = "WIFI PORTAL TIMEOUT";
    drawValues();
    return;
  }

  portalMode = false;
  statusText = cfgWallet.isEmpty() ? "NO WALLET CONFIG" : "LIVE " + WiFi.localIP().toString();
  drawValues();
}

void setup() {
  pinMode(TFT_BL, OUTPUT);
  digitalWrite(TFT_BL, HIGH);

  pinMode(REAR_LED, OUTPUT);
  rearLedOn();

  tft.init();
  loadPrefs();
  soloHunterMinerBegin(currentMiningEngineConfig());
  applyRotation();
  tft.setTextDatum(top_left);
  tft.fillScreen(C_BG);

  drawStaticLayout();
  statusText = "STARTING WIFI...";
  drawValues();

  if (WiFi.status() != WL_CONNECTED) {
    runWifiManagerPortal();
  }

  setupWebServer();

  if (WiFi.status() == WL_CONNECTED) {
    refreshWalletOnly();
    refreshFiatOnly();
    checkForMinedBlockAlert();
  }

  drawStaticLayout();
  drawValues();

  if (isBlockPopupVisible()) drawBlockPopup();

  lastWalletFetch = millis();
  lastFiatFetch = millis();
  lastMinedAlertCheck = millis();
  lastMiningDisplayRefresh = millis();
}

void loop() {
  rearLedOn();
  server.handleClient();

  if (portalMode) {
    runWifiManagerPortal();
    drawStaticLayout();
    drawValues();
  }

  if (WiFi.status() != WL_CONNECTED) {
    delay(100);
    return;
  }

  if (popupActive) {
    if (!isBlockPopupVisible()) {
      clearBlockPopup();
    } else {
      delay(20);
      return;
    }
  }

  servicePendingDataRefresh();

  if (millis() - lastMiningDisplayRefresh >= MINING_DISPLAY_REFRESH_MS) {
    lastMiningDisplayRefresh = millis();
    drawMiningStats();
  }

  if (millis() - lastWalletFetch >= WALLET_REFRESH_MS) {
    lastWalletFetch = millis();
    refreshWalletOnly();
    drawValues();
  }

  if (millis() - lastFiatFetch >= FIAT_REFRESH_MS) {
    lastFiatFetch = millis();
    refreshFiatOnly();
    drawValues();
  }

  if (millis() - lastMinedAlertCheck >= MINED_ALERT_REFRESH_MS) {
    lastMinedAlertCheck = millis();
    checkForMinedBlockAlert();
    if (isBlockPopupVisible()) drawBlockPopup();
  }

  delay(20);
}
