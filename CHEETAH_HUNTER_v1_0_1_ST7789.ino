// CHEETAH HUNTER v1.0.5 ST7789 Gleec Wallet price-ticker build
// Public/shareable build for ST7789 screen variant
//
// Features:
// - WiFiManager for first-time WiFi setup / recovery
// - local config page after connected
// - edit wallet + screen flip from browser
// - live CHTA wallet balance (10s refresh)
// - cached CHTA USD price from the same Gleec Wallet tickers_v2 feed used by the website
// - optional GBP/CAD values from CoinPaprika for alternate display currencies
// - no manual price multiplier / no made-up adjustment
// - BLOCK FOUND popup on mined tx or confirmed balance increase
//
// Required library:
//   WiFiManager by tzapu / tablatronix

#include <WiFi.h>
#include <WiFiClientSecure.h>
#include <HTTPClient.h>
#include <Preferences.h>
#include <LovyanGFX.hpp>
#include <WiFiManager.h>
#include <WebServer.h>

const char* AP_SSID = "CHEETAH_HUNTER_SETUP";
const char* AP_PASS = "solohunter";

#define TFT_BL 21
#define REAR_LED 17

static const uint32_t WALLET_REFRESH_MS = 10000;
static const uint32_t FIAT_REFRESH_MS   = 300000;
static const uint32_t MINED_ALERT_REFRESH_MS = 10000;
static const uint16_t BALANCE_CONNECT_TIMEOUT_MS = 5000;
static const uint16_t BALANCE_HTTP_TIMEOUT_MS    = 10000;
static const uint16_t PRICE_CONNECT_TIMEOUT_MS   = 5000;
static const uint16_t PRICE_HTTP_TIMEOUT_MS      = 10000;

Preferences prefs;
WebServer server(80);

String cfgWallet = "";
String cfgCurrency = "USD";
bool cfgFlip = false;
float cfgPriceAdjust = 1.0f;  // Locked to 1.0: live public API price only, no adjustment multiplier.
const char* PREFS_NS = "chta";

bool haveWalletData = false;
bool haveFiatData = false;
bool popupActive = false;
bool popupPersistent = false;
bool portalMode = false;
bool minedBaselineReady = false;

float balanceCHTA = 0.0f;
float chtaPriceUsd = 0.0f;
float chtaPriceGbp = 0.0f;
float chtaPriceCad = 0.0f;
float walletFiatValue = 0.0f;
float lastBalanceCHTA = -1.0f;
float deltaCHTA = 0.0f;

String statusText = "BOOT";
String lastMinedTxId = "";
unsigned long popupUntil = 0;
unsigned long lastWalletFetch = 0;
unsigned long lastFiatFetch = 0;
unsigned long lastMinedAlertCheck = 0;

bool isBlockPopupVisible();

String chainzUrl() {
  // Iquidus-style explorer API for Cheetahcoin balance.
  return String("http://chtaexplorer.mooo.com:3002/ext/getbalance/") + cfgWallet;
}

String coinpaprikaTickerUrl() {
  return String("https://api.coinpaprika.com/v1/tickers/chta-cheetahcoin?quotes=USD,GBP,CAD");
}

String gleecWalletTickersUrl() {
  return String("https://defistats.gleec.com/api/v3/prices/tickers_v2?expire_at=600");
}

String minedTxUrl() {
  // Placeholder: Cheetahcoin public explorer may not expose the same mined-transaction API used by the original build.
  return String("http://chtaexplorer.mooo.com:3002/ext/getaddress/") + cfgWallet;
}

class LGFX : public lgfx::LGFX_Device {
  lgfx::Panel_ST7789 _panel;
  lgfx::Bus_SPI _bus;
public:
  LGFX(void) {
    {
      auto cfg = _bus.config();
      cfg.spi_host = HSPI_HOST;
      cfg.spi_mode = 0;
      cfg.freq_write = 40000000;
      cfg.freq_read = 16000000;
      cfg.spi_3wire = false;
      cfg.use_lock = true;
      cfg.dma_channel = 1;
      cfg.pin_sclk = 14;
      cfg.pin_mosi = 13;
      cfg.pin_miso = 12;
      cfg.pin_dc   = 2;
      _bus.config(cfg);
      _panel.setBus(&_bus);
    }
    {
      auto cfg = _panel.config();
      cfg.pin_cs = 15;
      cfg.pin_rst = -1;
      cfg.pin_busy = -1;
      cfg.memory_width = 240;
      cfg.memory_height = 320;
      cfg.panel_width = 240;
      cfg.panel_height = 320;
      cfg.offset_x = 0;
      cfg.offset_y = 0;
      cfg.offset_rotation = 0;
      cfg.dummy_read_pixel = 8;
      cfg.dummy_read_bits = 1;
      cfg.readable = true;
      cfg.invert = false;
      cfg.rgb_order = false;
      cfg.dlen_16bit = false;
      cfg.bus_shared = true;
      _panel.config(cfg);
    }
    setPanel(&_panel);
  }
} tft;

static constexpr uint16_t C_BG      = TFT_BLACK;
static constexpr uint16_t C_GREEN   = 0x07E0;
static constexpr uint16_t C_GREEN2  = 0x05A0;
static constexpr uint16_t C_DIM     = 0x7BEF;
static constexpr uint16_t C_WARN    = TFT_YELLOW;
static constexpr uint16_t C_ALERT   = TFT_RED;
static constexpr uint16_t C_POPBG   = 0x0120;

const int IMG_W = 172;
const int IMG_H = 150;
static const uint16_t acceptedImg[IMG_W * IMG_H] PROGMEM = {
  0x0000, 0x0000, 0x0000, 0x0000, 0x0000, 0x0000, 0x0000, 0x0000, 0x0000, 0x0000, 0x0000, 0x0000,
  0x0000, 0x0000, 0x0000, 0x0000, 0x0000, 0x0000, 0x0000, 0x0000, 0x0000, 0x0000, 0x0000, 0x0000,
  0x0000, 0x0000, 0x0000, 0x0000, 0x0000, 0x0000, 0x0000, 0x0000, 0x0000, 0x0000, 0x0000, 0x0000,
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  0x0000, 0x0000, 0x0000, 0x0000, 0x0000, 0x0000, 0x0000, 0x0000, 0x0000, 0x0000, 0x0000, 0x0000
};

void rearLedOn() {
  digitalWrite(REAR_LED, LOW);
}

String fmt2(float v) {
  char buf[24];
  dtostrf(v, 0, 2, buf);
  return String(buf);
}

String fmtDecimals(float v, uint8_t decimals) {
  char buf[24];
  dtostrf(v, 0, decimals, buf);
  return String(buf);
}

String normalizeCurrency(String currency) {
  currency.trim();
  currency.toUpperCase();
  if (currency == "GBP" || currency == "CAD") return currency;
  return "USD";
}

String currentCurrencyCode() {
  return normalizeCurrency(cfgCurrency);
}

String currencyDisplayName(const String& currencyCode) {
  if (currencyCode == "GBP") return "Great British Pound";
  if (currencyCode == "CAD") return "Canadian Dollar";
  return "US Dollar";
}

String currencyPrefix(const String& currencyCode) {
  if (currencyCode == "GBP") return "\xC2\xA3";
  if (currencyCode == "CAD") return "CAD$";
  return "$";
}

String currencyPrefixHtml(const String& currencyCode) {
  if (currencyCode == "GBP") return "&pound;";
  if (currencyCode == "CAD") return "CAD$";
  return "$";
}

float chtaPriceForCurrency(const String& currencyCode) {
  if (currencyCode == "GBP") return chtaPriceGbp;
  if (currencyCode == "CAD") return chtaPriceCad;
  return chtaPriceUsd;
}

float currentRawChtaFiatPrice() {
  return chtaPriceForCurrency(currentCurrencyCode());
}

float currentChtaFiatPrice() {
  return currentRawChtaFiatPrice();
}

float currentWalletFiatValue() {
  float price = currentChtaFiatPrice();
  if (!(haveWalletData && price > 0.0f)) return 0.0f;
  return balanceCHTA * price;
}

void syncFiatAvailability() {
  haveFiatData = (currentChtaFiatPrice() > 0.0f);
}

String currentCurrencyWaitText() {
  return currentCurrencyCode() + " WAIT";
}

String formatFiatAmount(const String& currencyCode, float amount, uint8_t decimals) {
  return currencyPrefix(currencyCode) + fmtDecimals(amount, decimals);
}

String currentFiatAmountText(float amount, uint8_t decimals) {
  return formatFiatAmount(currentCurrencyCode(), amount, decimals);
}

void drawPoundGlyph2x(int x, int y, uint16_t color, uint16_t bg) {
  static const uint8_t poundGlyph[8] = {
    0b001110,
    0b010001,
    0b010000,
    0b111100,
    0b011000,
    0b111100,
    0b010000,
    0b111110
  };

  tft.fillRect(x, y, 12, 16, bg);
  for (int row = 0; row < 8; ++row) {
    for (int col = 0; col < 6; ++col) {
      if (poundGlyph[row] & (1 << (5 - col))) {
        tft.fillRect(x + (col * 2), y + (row * 2), 2, 2, color);
      }
    }
  }
}

String currentCurrencyRetryText() {
  return currentCurrencyCode() + " RETRY";
}

String liveCurrencyWaitStatus() {
  return "LIVE / " + currentCurrencyCode() + " WAIT";
}

float extractJsonFloat(const String& body, const char* key) {
  int pos = body.indexOf(key);
  if (pos < 0) return 0.0f;

  String sub = body.substring(pos + strlen(key));
  int comma = sub.indexOf(",");
  int brace = sub.indexOf("}");
  int end = comma;

  if (end < 0 || (brace >= 0 && brace < end)) end = brace;
  if (end > 0) sub = sub.substring(0, end);
  sub.trim();
  sub.replace("\"", "");
  return sub.toFloat();
}

float extractCoinpaprikaQuotePrice(const String& rawBody, const char* currencyCode) {
  String body = rawBody;
  body.replace("\n", "");
  body.replace("\r", "");
  body.replace("\t", "");
  body.replace(" ", "");
  String key = "\"" + String(currencyCode) + "\":{\"price\":";
  return extractJsonFloat(body, key.c_str());
}

String compactJson(String body) {
  body.replace("\n", "");
  body.replace("\r", "");
  body.replace("\t", "");
  body.replace(" ", "");
  return body;
}

String extractJsonStringValue(const String& body, const char* key) {
  int pos = body.indexOf(key);
  if (pos < 0) return "";
  int start = pos + strlen(key);
  int end = body.indexOf("\"", start);
  if (end < 0 || end <= start) return "";
  return body.substring(start, end);
}

bool extractLatestMinedTx(const String& rawBody, String& txid, float& received) {
  String body = compactJson(rawBody);
  int typePos = body.indexOf("\"type\":\"mined\"");
  if (typePos < 0) return false;

  int objStart = body.lastIndexOf("{", typePos);
  int objEnd = body.indexOf("}", typePos);
  if (objStart < 0 || objEnd < 0 || objEnd <= objStart) return false;

  String obj = body.substring(objStart, objEnd + 1);
  txid = extractJsonStringValue(obj, "\"txid\":\"");
  received = extractJsonStringValue(obj, "\"received\":\"").toFloat();
  if (received <= 0.0f) received = extractJsonFloat(obj, "\"received\":");
  if (received <= 0.0f) received = extractJsonFloat(obj, "\"amount\":");
  if (received <= 0.0f) received = extractJsonFloat(obj, "\"value\":");
  return !txid.isEmpty();
}

String currencyChoiceHtml(const char* code, const char* label, const char* hint) {
  String checked = currentCurrencyCode() == code ? " checked" : "";
  return
    "<label class='choice'>"
      "<input type='radio' name='currency' value='" + String(code) + "'" + checked + ">"
      "<span class='choice-body'>"
        "<span class='choice-code'>" + String(code) + "</span>"
        "<span class='choice-label'>" + String(label) + "</span>"
        "<span class='choice-hint'>" + String(hint) + "</span>"
      "</span>"
    "</label>";
}

void trimConfig() {
  cfgWallet.trim();
  cfgCurrency = normalizeCurrency(cfgCurrency);
}

void savePrefs() {
  trimConfig();
  prefs.begin(PREFS_NS, false);
  prefs.putString("wallet", cfgWallet);
  prefs.putString("currency", cfgCurrency);
  prefs.putBool("flip", cfgFlip);
  prefs.putString("lastmtx", lastMinedTxId);
  prefs.putBool("minebase", minedBaselineReady);
  prefs.putFloat("lastbal", lastBalanceCHTA);
  prefs.putFloat("lastusd", chtaPriceUsd);
  prefs.putFloat("lastgbp", chtaPriceGbp);
  prefs.putFloat("lastcad", chtaPriceCad);
  prefs.end();
}

void loadPrefs() {
  prefs.begin(PREFS_NS, true);
  cfgWallet = prefs.getString("wallet", "");
  cfgCurrency = prefs.getString("currency", "USD");
  cfgFlip = prefs.getBool("flip", false);
  cfgPriceAdjust = 1.0f;
  lastMinedTxId = prefs.getString("lastmtx", "");
  minedBaselineReady = prefs.getBool("minebase", false);
  lastBalanceCHTA = prefs.getFloat("lastbal", -1.0f);
  chtaPriceUsd = prefs.getFloat("lastusd", 0.0f);
  chtaPriceGbp = prefs.getFloat("lastgbp", 0.0f);
  chtaPriceCad = prefs.getFloat("lastcad", 0.0f);
  prefs.end();
  trimConfig();
  syncFiatAvailability();
}

void saveLastBalance() {
  prefs.begin(PREFS_NS, false);
  prefs.putFloat("lastbal", lastBalanceCHTA);
  prefs.end();
}

void saveMinedAlertState() {
  prefs.begin(PREFS_NS, false);
  prefs.putString("lastmtx", lastMinedTxId);
  prefs.putBool("minebase", minedBaselineReady);
  prefs.end();
}

void saveLastFiatPrices() {
  prefs.begin(PREFS_NS, false);
  prefs.putFloat("lastusd", chtaPriceUsd);
  prefs.putFloat("lastgbp", chtaPriceGbp);
  prefs.putFloat("lastcad", chtaPriceCad);
  prefs.end();
}

void applyRotation() {
  tft.setRotation(cfgFlip ? 3 : 1);
}

String currentIpText() {
  if (WiFi.status() == WL_CONNECTED) return WiFi.localIP().toString();
  return "NO WIFI";
}

String htmlEscape(String s) {
  s.replace("&", "&amp;");
  s.replace("<", "&lt;");
  s.replace(">", "&gt;");
  s.replace("\"", "&quot;");
  return s;
}

void drawBorder() {
  tft.drawRect(0, 0, 320, 240, C_GREEN);
  tft.drawRect(1, 1, 318, 238, C_GREEN);
  tft.drawRect(2, 2, 316, 236, C_GREEN2);
  tft.drawRect(3, 3, 314, 234, C_GREEN2);
}

void drawStaticLayout() {
  tft.fillScreen(C_BG);
  drawBorder();

  tft.setTextColor(C_GREEN, C_BG);
  tft.setTextSize(2);
  tft.setCursor(62, 10);
  tft.print("CHEETAH_HUNTER");

  int imgX = (320 - IMG_W) / 2;
  int imgY = 34;
  tft.setSwapBytes(true);
  tft.pushImage(imgX, imgY, IMG_W, IMG_H, acceptedImg);
  tft.setSwapBytes(false);

  tft.drawFastHLine(20, 180, 280, C_GREEN2);
  tft.drawFastHLine(20, 222, 280, C_GREEN2);

  tft.setTextSize(1);
  tft.setTextColor(C_DIM, C_BG);
  tft.setCursor(24, 186);
  tft.print("CHTA BAL");
  String fiatLabel = currentCurrencyCode() + " VALUE";
  int fiatLabelX = 296 - tft.textWidth(fiatLabel);
  if (fiatLabelX < 216) fiatLabelX = 216;
  tft.setCursor(fiatLabelX, 186);
  tft.print(fiatLabel);
  tft.setCursor(24, 226);
  tft.print("STATUS");
}

void drawValues() {
  tft.fillRect(20, 194, 280, 24, C_BG);
  tft.setTextSize(2);
  walletFiatValue = 0.0f;

  if (haveWalletData) {
    tft.setTextColor(C_GREEN, C_BG);
    tft.setCursor(24, 196);
    tft.print(fmt2(balanceCHTA));

    String currencyCode = currentCurrencyCode();
    String fiatText = currentCurrencyWaitText();
    bool drawCustomPound = false;
    String fiatAmountText = "";
    if (haveFiatData) {
      walletFiatValue = currentWalletFiatValue();
      if (currencyCode == "GBP") {
        fiatAmountText = fmt2(walletFiatValue);
        drawCustomPound = true;
      } else {
        fiatText = currentFiatAmountText(walletFiatValue, 2);
      }
      tft.setTextColor(C_GREEN, C_BG);
    } else {
      tft.setTextColor(C_WARN, C_BG);
    }

    if (drawCustomPound) {
      const int poundWidth = 12;
      const int poundGap = 2;
      int amountX = 296 - tft.textWidth(fiatAmountText);
      int poundX = amountX - poundGap - poundWidth;

      if (poundX < 144) {
        poundX = 144;
        amountX = poundX + poundWidth + poundGap;
      }

      drawPoundGlyph2x(poundX, 196, C_GREEN, C_BG);
      tft.setCursor(amountX, 196);
      tft.print(fiatAmountText);
    } else {
      int fiatX = 296 - tft.textWidth(fiatText);
      if (fiatX < 144) fiatX = 144;
      tft.setCursor(fiatX, 196);
      tft.print(fiatText);
    }
  } else {
    if (WiFi.status() == WL_CONNECTED && cfgWallet.isEmpty()) {
      tft.setTextSize(1);
      tft.setTextColor(C_WARN, C_BG);
      tft.setCursor(24, 203);
      tft.print("CONNECT TO ");
      tft.setTextColor(C_GREEN, C_BG);
      tft.print(WiFi.localIP().toString());
    } else {
      tft.setTextColor(C_WARN, C_BG);
      tft.setCursor(24, 196);
      tft.print("NO DATA");
    }
  }

  tft.fillRect(78, 224, 222, 12, C_BG);
  tft.setTextSize(1);
  tft.setTextColor(statusText.startsWith("LIVE") ? C_GREEN : C_ALERT, C_BG);
  tft.setCursor(78, 226);
  tft.print(statusText);
}

void drawBlockPopup() {
  if (!isBlockPopupVisible()) return;

  // Bigger centered card
  int w = 240;
  int h = 90;
  int x = (320 - w) / 2;
  int y = (240 - h) / 2;

  tft.fillRoundRect(x, y, w, h, 12, C_POPBG);
  tft.drawRoundRect(x, y, w, h, 12, C_GREEN);
  tft.drawRoundRect(x+1, y+1, w-2, h-2, 12, C_GREEN2);

  // Title
  tft.setTextColor(C_WARN, C_POPBG);
  tft.setTextSize(2);
  tft.setCursor(x + 40, y + 15);
  tft.print("BLOCK FOUND");

  // Amount (supports large rewards)
  tft.setTextColor(C_GREEN, C_POPBG);
  tft.setTextSize(2);

  String reward = "+" + fmt2(deltaCHTA) + " CHTA";

  // center text dynamically
  int16_t textWidth = reward.length() * 12; // approx width
  int textX = x + (w - textWidth) / 2;

  tft.setCursor(textX, y + 50);
  tft.print(reward);
}

void startBlockPopup(float amount) {
  deltaCHTA = amount;
  popupActive = true;
  popupPersistent = true;
  popupUntil = 0;
  drawBlockPopup();
}

bool isBlockPopupVisible() {
  return popupActive && (popupPersistent || millis() < popupUntil);
}

void clearBlockPopup() {
  popupActive = false;
  popupPersistent = false;
  popupUntil = 0;
  drawStaticLayout();
  drawValues();
}

bool fetchChtaBalance() {
  if (WiFi.status() != WL_CONNECTED) {
    statusText = "BAL RETRY";
    // Keep last good wallet data on screen if we already have it.
    return false;
  }

  if (cfgWallet.isEmpty()) {
    statusText = "NO WALLET CONFIG";
    // Keep last good wallet data on screen if we already have it.
    return false;
  }

  WiFiClient client;
  HTTPClient http;
  http.setConnectTimeout(BALANCE_CONNECT_TIMEOUT_MS);
  http.setTimeout(BALANCE_HTTP_TIMEOUT_MS);
  http.setUserAgent("ESP32-CHEETAH-HUNTER/1.0.5");

  if (!http.begin(client, chainzUrl())) {
    statusText = "BAL RETRY";
    return false;
  }

  int code = http.GET();
  if (code != 200) {
    statusText = "BAL HTTP " + String(code);
    http.end();
    return false;
  }

  String body = http.getString();
  http.end();
  body.trim();

  if (!body.length() || body.startsWith("ERROR")) {
    statusText = "BAL RETRY";
    return false;
  }

  balanceCHTA = body.toFloat();
  haveWalletData = true;
  return true;
}

bool applyCoinpaprikaFiatPrices(const String& body) {
  bool updated = false;
  float usd = extractCoinpaprikaQuotePrice(body, "USD");
  float gbp = extractCoinpaprikaQuotePrice(body, "GBP");
  float cad = extractCoinpaprikaQuotePrice(body, "CAD");

  if (usd > 0.0f) {
    chtaPriceUsd = usd;
    updated = true;
  }
  if (gbp > 0.0f) {
    chtaPriceGbp = gbp;
    updated = true;
  }
  if (cad > 0.0f) {
    chtaPriceCad = cad;
    updated = true;
  }

  if (!updated) return false;

  saveLastFiatPrices();
  syncFiatAvailability();
  return haveFiatData;
}

bool fetchGleecWalletUsdPrice(float& price) {
  price = 0.0f;

  WiFiClientSecure client;
  client.setInsecure();
  HTTPClient http;
  http.setConnectTimeout(PRICE_CONNECT_TIMEOUT_MS);
  http.setTimeout(PRICE_HTTP_TIMEOUT_MS);
  http.setUserAgent("ESP32-CHEETAH-HUNTER/1.0.5");

  if (!http.begin(client, gleecWalletTickersUrl())) return false;

  int code = http.GET();
  if (code != 200) {
    http.end();
    return false;
  }

  WiFiClient* stream = http.getStreamPtr();
  const char* key = "\"CHTA\":";
  size_t matched = 0;
  bool foundKey = false;
  bool inObject = false;
  int braceDepth = 0;
  String obj;
  obj.reserve(420);

  unsigned long deadline = millis() + PRICE_HTTP_TIMEOUT_MS;
  while (http.connected() && millis() < deadline) {
    while (stream->available()) {
      char c = (char)stream->read();

      if (!foundKey) {
        if (c == key[matched]) {
          matched++;
          if (key[matched] == '\0') foundKey = true;
        } else {
          matched = (c == key[0]) ? 1 : 0;
        }
        continue;
      }

      if (!inObject) {
        if (c == '{') {
          inObject = true;
          braceDepth = 1;
          obj = "{";
        }
        continue;
      }

      obj += c;
      if (c == '{') {
        braceDepth++;
      } else if (c == '}') {
        braceDepth--;
        if (braceDepth == 0) {
          http.end();
          price = extractJsonFloat(obj, "\"last_price\":");
          return price > 0.0f;
        }
      }

      if (obj.length() > 900) {
        http.end();
        return false;
      }
    }
    delay(1);
  }

  http.end();
  return false;
}

void markFiatFetchFailed(const String& detail) {
  syncFiatAvailability();
  if (haveWalletData) {
    statusText = liveCurrencyWaitStatus();
  } else {
    statusText = detail;
  }
}

bool fetchChtaFiatPrices() {
  if (WiFi.status() != WL_CONNECTED) {
    markFiatFetchFailed(currentCurrencyRetryText());
    return false;
  }

  float usd = 0.0f;
  if (fetchGleecWalletUsdPrice(usd)) {
    chtaPriceUsd = usd;
    saveLastFiatPrices();
    syncFiatAvailability();
    if (currentCurrencyCode() == "USD") return haveFiatData;
  }

  WiFiClientSecure client;
  client.setInsecure();
  HTTPClient http;
  http.setConnectTimeout(PRICE_CONNECT_TIMEOUT_MS);
  http.setTimeout(PRICE_HTTP_TIMEOUT_MS);
  http.setUserAgent("ESP32-CHEETAH-HUNTER/1.0.5");

  if (!http.begin(client, coinpaprikaTickerUrl())) {
    markFiatFetchFailed(currentCurrencyRetryText());
    return false;
  }

  int code = http.GET();
  if (code != 200) {
    String detail = (code == 429) ? "PRICE RATE LIMIT" : currentCurrencyCode() + " HTTP " + String(code);
    http.end();
    markFiatFetchFailed(detail);
    return false;
  }

  String body = http.getString();
  http.end();

  if (applyCoinpaprikaFiatPrices(body)) return true;

  markFiatFetchFailed(currentCurrencyCode() + " PARSE FAIL");
  return false;
}

bool fetchLatestMinedTx(String& txid, float& received) {
  if (WiFi.status() != WL_CONNECTED || cfgWallet.isEmpty()) return false;

  WiFiClient client;
  HTTPClient http;
  http.setConnectTimeout(BALANCE_CONNECT_TIMEOUT_MS);
  http.setTimeout(BALANCE_HTTP_TIMEOUT_MS);
  http.setUserAgent("ESP32-CHEETAH-HUNTER/1.0.5");

  if (!http.begin(client, minedTxUrl())) return false;

  int code = http.GET();
  if (code != 200) {
    http.end();
    return false;
  }

  String body = http.getString();
  http.end();
  return extractLatestMinedTx(body, txid, received);
}

void checkForMinedBlockAlert() {
  if (WiFi.status() != WL_CONNECTED || cfgWallet.isEmpty()) return;

  String txid;
  float received = 0.0f;
  bool foundMinedTx = fetchLatestMinedTx(txid, received);

  if (!minedBaselineReady) {
    if (foundMinedTx) lastMinedTxId = txid;
    minedBaselineReady = true;
    saveMinedAlertState();
    return;
  }

  if (!foundMinedTx || txid.isEmpty() || txid == lastMinedTxId) return;

  lastMinedTxId = txid;
  if (received > 0.0f || !popupActive) {
    startBlockPopup(received);
  }
  saveMinedAlertState();
}

void refreshWalletOnly() {
  bool balOk = fetchChtaBalance();
  if (balOk) {
    statusText = "LIVE " + WiFi.localIP().toString();

    if (lastBalanceCHTA < 0.0f) {
      lastBalanceCHTA = balanceCHTA;
      saveLastBalance();
    } else if (balanceCHTA != lastBalanceCHTA) {
      if (balanceCHTA > lastBalanceCHTA) {
        startBlockPopup(balanceCHTA - lastBalanceCHTA);
      }
      lastBalanceCHTA = balanceCHTA;
      saveLastBalance();
    }
  } else if (haveWalletData) {
    statusText = "LIVE / BAL RETRY";
  }
}

void refreshFiatOnly() {
  if (!haveWalletData || cfgWallet.isEmpty()) return;
  bool fiatOk = fetchChtaFiatPrices();
  if (fiatOk) {
    statusText = "LIVE " + WiFi.localIP().toString();
  } else if (haveWalletData && haveFiatData) {
    statusText = liveCurrencyWaitStatus();
  }
}

void handleRoot() {
  String currencyCode = currentCurrencyCode();
  String walletBalanceText = haveWalletData ? fmt2(balanceCHTA) + " CHTA" : (cfgWallet.isEmpty() ? "Add wallet address" : "Waiting for wallet");
  String walletValueText = haveWalletData && haveFiatData ? currencyPrefixHtml(currencyCode) + fmtDecimals(currentWalletFiatValue(), 2) : (haveWalletData ? currentCurrencyWaitText() : "--");
  String priceText = haveFiatData ? currencyPrefixHtml(currencyCode) + fmtDecimals(currentChtaFiatPrice(), 8) : currentCurrencyWaitText();
  String screenModeText = cfgFlip ? "Flipped 180" : "Standard";

  String page;
  page.reserve(9000);
  page += "<!doctype html><html><head><meta name='viewport' content='width=device-width,initial-scale=1'>";
  page += "<title>CHEETAH HUNTER Control Panel</title>";
  page += "<style>";
  page += ":root{--bg:#07110b;--panel:#101a13;--panel-2:#152319;--line:#294433;--accent:#62ff9b;--accent-2:#1cc86d;--text:#edf7f0;--muted:#9db5a5;--shadow:0 24px 60px rgba(0,0,0,.35)}";
  page += "*{box-sizing:border-box}body{margin:0;min-height:100vh;padding:24px;color:var(--text);font-family:'Trebuchet MS','Segoe UI',sans-serif;background:radial-gradient(circle at top,#16301d 0,#08100a 58%,#050806 100%)}";
  page += "body::before{content:'';position:fixed;inset:0;background:linear-gradient(135deg,rgba(98,255,155,.08),transparent 42%),radial-gradient(circle at top right,rgba(98,255,155,.16),transparent 30%);pointer-events:none}";
  page += ".shell{max-width:1080px;margin:0 auto;display:grid;gap:18px;position:relative;z-index:1}.panel{background:linear-gradient(180deg,rgba(21,35,25,.98),rgba(10,18,12,.94));border:1px solid var(--line);border-radius:24px;padding:22px;box-shadow:var(--shadow)}";
  page += ".hero{padding:28px}.eyebrow{text-transform:uppercase;letter-spacing:.18em;font-size:12px;color:var(--accent)}h1{margin:8px 0 10px;font-size:clamp(28px,5vw,44px);line-height:1.04}.hero-copy,.section-head p,.action-panel p{margin:0;color:var(--muted);line-height:1.55}";
  page += ".chip-row{display:flex;flex-wrap:wrap;gap:10px;margin-top:18px}.pill{display:inline-flex;align-items:center;padding:10px 14px;border-radius:999px;background:rgba(98,255,155,.08);border:1px solid rgba(98,255,155,.22);color:#e4ffed;font-size:14px}";
  page += ".layout{display:grid;grid-template-columns:1.08fr .92fr;gap:18px}.section-head{display:flex;justify-content:space-between;align-items:flex-start;gap:12px;margin-bottom:18px}.section-head h2,.action-panel h2{margin:0 0 6px;font-size:22px}";
  page += ".stats{display:grid;grid-template-columns:repeat(2,minmax(0,1fr));gap:14px}.stat{padding:16px;border-radius:18px;background:linear-gradient(180deg,rgba(7,17,11,.82),rgba(12,22,15,.95));border:1px solid rgba(98,255,155,.12)}";
  page += ".stat-label{display:block;font-size:12px;text-transform:uppercase;letter-spacing:.08em;color:var(--muted);margin-bottom:10px}.stat strong{display:block;font-size:28px;line-height:1.1;margin-bottom:8px}.stat small{color:var(--muted);font-size:13px}";
  page += ".field-label{display:block;font-size:13px;text-transform:uppercase;letter-spacing:.08em;color:var(--muted);margin-bottom:10px}input{width:100%;padding:14px 16px;border-radius:16px;border:1px solid #35533f;background:#0b140e;color:var(--text);font-size:15px;outline:none}";
  page += "input:focus{border-color:var(--accent);box-shadow:0 0 0 3px rgba(98,255,155,.12)}.choices{display:grid;grid-template-columns:repeat(3,minmax(0,1fr));gap:12px;margin-bottom:18px}.choice{display:block;position:relative;cursor:pointer}";
  page += ".choice input{position:absolute;opacity:0;pointer-events:none}.choice-body{display:block;padding:16px;border-radius:18px;border:1px solid #35533f;background:#0b140e;transition:transform .15s ease,border-color .15s ease,box-shadow .15s ease}";
  page += ".choice input:checked + .choice-body{border-color:var(--accent);box-shadow:0 0 0 3px rgba(98,255,155,.16);transform:translateY(-1px)}.choice-code{display:block;font-size:20px;font-weight:700;margin-bottom:8px}.choice-label{display:block;font-size:14px;font-weight:700;margin-bottom:6px}.choice-hint{display:block;font-size:12px;color:var(--muted);line-height:1.45}";
  page += ".toggle-row{display:grid;gap:12px;margin:18px 0 22px}.toggle{display:flex;align-items:center;gap:12px;padding:14px 16px;border-radius:16px;background:#0b140e;border:1px solid #2e4936}.toggle input{width:18px;height:18px;accent-color:var(--accent-2);margin:0}";
  page += ".actions{display:flex;gap:12px;flex-wrap:wrap}button{appearance:none;border:none;border-radius:16px;padding:14px 18px;font-weight:700;font-size:15px;cursor:pointer;transition:transform .15s ease,box-shadow .15s ease}button:hover{transform:translateY(-1px)}";
  page += ".primary{background:linear-gradient(135deg,var(--accent),var(--accent-2));color:#041109;box-shadow:0 12px 30px rgba(28,200,109,.25)}.secondary{background:#0b140e;color:var(--text);border:1px solid #35533f}.action-panel{display:flex;justify-content:space-between;align-items:center;gap:16px}";
  page += "@media (max-width:900px){body{padding:16px}.layout{grid-template-columns:1fr}.stats,.choices{grid-template-columns:1fr}.action-panel{flex-direction:column;align-items:flex-start}}";
  page += "</style></head><body><main class='shell'>";
  page += "<section class='hero panel'><div class='eyebrow'>CHEETAH HUNTER Control Panel</div>";
  page += "<h1>Cleaner setup, live wallet checks, and one-tap currency switching.</h1>";
  page += "<p class='hero-copy'>Use this page to update the wallet address, flip the screen, and choose whether the device shows wallet value in USD, GBP, or CAD.</p>";
  page += "<div class='chip-row'>";
  page += "<span class='pill' id='chipIp'>IP: " + htmlEscape(currentIpText()) + "</span>";
  page += "<span class='pill' id='chipStatus'>Status: " + htmlEscape(statusText) + "</span>";
  page += "<span class='pill' id='chipCurrency'>Currency: " + htmlEscape(currencyCode) + " | " + htmlEscape(currencyDisplayName(currencyCode)) + "</span>";
  page += "</div></section>";
  page += "<section class='layout'>";
  page += "<div class='panel'><div class='section-head'><div><h2>Live Dashboard</h2><p>Selected currency drives both the screen value and the live browser stats below.</p></div><span class='pill'>" + htmlEscape(currencyDisplayName(currencyCode)) + "</span></div>";
  page += "<div class='stats'>";
  page += "<article class='stat'><span class='stat-label'>Wallet Balance</span><strong id='balanceChta'>" + htmlEscape(walletBalanceText) + "</strong><small>Current Cheetahcoin balance from the CHTA explorer.</small></article>";
  page += "<article class='stat'><span class='stat-label'>Wallet Value</span><strong id='walletFiat'>" + walletValueText + "</strong><small>The value currently shown on the device.</small></article>";
  page += "<article class='stat'><span class='stat-label'>CHTA Price</span><strong id='priceFiat'>" + priceText + "</strong><small>Uses Gleec when CHTA is present; otherwise CoinPaprika USD/GBP/CAD.</small></article>";
  page += "<article class='stat'><span class='stat-label'>Screen Mode</span><strong id='screenMode'>" + htmlEscape(screenModeText) + "</strong><small>Current display orientation.</small></article>";
  page += "</div></div>";
  page += "<div class='panel'><div class='section-head'><div><h2>Device Settings</h2><p>Everything important is on one page so the device is easier to configure and check at a glance.</p></div></div>";
  page += "<form method='POST' action='/save'>";
  page += "<label class='field-label' for='wallet'>CHTA Wallet Address</label>";
  page += "<input id='wallet' name='wallet' value='" + htmlEscape(cfgWallet) + "' placeholder='Enter your Cheetahcoin wallet address'>";
  page += "<p style='margin:8px 0 16px;color:var(--muted);line-height:1.45;font-size:13px'>USD source: Gleec Wallet tickers_v2 feed. GBP/CAD source: CoinPaprika. No manual multiplier is used.</p>";
  page += "<div class='field-label'>Display Currency</div>";
  page += "<div class='choices'>";
  page += currencyChoiceHtml("USD", "US Dollar", "Standard US dollar wallet value");
  page += currencyChoiceHtml("GBP", "Great British Pound", "British pound wallet value");
  page += currencyChoiceHtml("CAD", "Canadian Dollar", "Canadian dollar wallet value");
  page += "</div>";
  page += "<div class='toggle-row'>";
  page += "<label class='toggle'><input type='checkbox' name='flip' " + String(cfgFlip ? "checked" : "") + "><span>Flip screen 180&deg;</span></label>";
  page += "</div>";
  page += "<div class='actions'><button class='primary' type='submit'>Save Settings</button></div>";
  page += "</form></div></section>";
  page += "<section class='panel action-panel'><div><h2>Block Alert</h2><p>Dismiss the current block-found message on the device.</p></div>";
  page += "<form method='POST' action='/clear-popup'><button class='secondary' type='submit'>Clear BLOCK FOUND notification</button></form></section>";
  page += "<section class='panel action-panel'><div><h2>WiFi Setup</h2><p>Need a different network? Reopen the captive portal without reflashing the board.</p></div>";
  page += "<form method='POST' action='/wifi'><button class='secondary' type='submit'>Open WiFi Setup Portal</button></form></section>";
  page += "<script>";
  page += "const fmt=(n,d=2)=>Number.isFinite(n)?n.toFixed(d):'--';";
  page += "const prefix=(c)=>c==='GBP'?'\\u00A3':(c==='CAD'?'CAD$':'$');";
  page += "async function refreshStatus(){try{const res=await fetch('/status',{cache:'no-store'});if(!res.ok)return;const s=await res.json();";
  page += "document.getElementById('chipIp').textContent='IP: '+(s.ip||'NO WIFI');";
  page += "document.getElementById('chipStatus').textContent='Status: '+(s.status||'BOOT');";
  page += "document.getElementById('chipCurrency').textContent='Currency: '+(s.currency||'USD')+' | '+(s.currency_name||'US Dollar');";
  page += "document.getElementById('balanceChta').textContent=s.have_wallet_data?fmt(s.balance_chta)+' CHTA':((s.wallet_configured?'Waiting for wallet':'Add wallet address'));";
  page += "document.getElementById('walletFiat').textContent=s.have_wallet_data&&s.have_fiat_data?(prefix(s.currency)+fmt(s.wallet_fiat)):((s.currency||'USD')+' WAIT');";
  page += "document.getElementById('priceFiat').textContent=s.have_fiat_data?(prefix(s.currency)+fmt(s.chta_fiat,8)):((s.currency||'USD')+' WAIT');";
  page += "document.getElementById('screenMode').textContent=s.flip?'Flipped 180':'Standard';";
  page += "}catch(e){}}refreshStatus();setInterval(refreshStatus,5000);";
  page += "</script></main></body></html>";
  server.send(200, "text/html", page);
}

void handleSave() {
  String oldWallet = cfgWallet;
  if (server.hasArg("wallet")) cfgWallet = server.arg("wallet");
  if (server.hasArg("currency")) cfgCurrency = server.arg("currency");
  cfgFlip = server.hasArg("flip");
  trimConfig();
  bool walletChanged = (cfgWallet != oldWallet);

  if (walletChanged) {
    haveWalletData = false;
    popupActive = false;
    popupPersistent = false;
    popupUntil = 0;
    deltaCHTA = 0.0f;
    lastBalanceCHTA = -1.0f;
    lastMinedTxId = "";
    minedBaselineReady = false;
  }

  syncFiatAvailability();
  savePrefs();
  applyRotation();

  if (WiFi.status() == WL_CONNECTED) {
    refreshWalletOnly();
    refreshFiatOnly();
    checkForMinedBlockAlert();
  }

  drawStaticLayout();
  drawValues();
  lastWalletFetch = millis();
  lastFiatFetch = millis();
  lastMinedAlertCheck = millis();

  server.sendHeader("Location", "/", true);
  server.send(303, "text/plain", "");
}

void handleOpenWifiPortal() {
  portalMode = true;
  server.send(200, "text/html",
    "<!doctype html><html><head><meta name='viewport' content='width=device-width,initial-scale=1'>"
    "<title>WiFi Setup Requested</title>"
    "<style>body{margin:0;min-height:100vh;display:grid;place-items:center;background:#08100a;color:#edf7f0;font-family:'Trebuchet MS','Segoe UI',sans-serif;padding:20px}"
    ".card{max-width:520px;padding:24px;border-radius:22px;background:linear-gradient(180deg,#152319,#0b140e);border:1px solid #294433;box-shadow:0 24px 60px rgba(0,0,0,.35)}"
    "h2{margin:0 0 10px;color:#62ff9b}p{margin:0;color:#9db5a5;line-height:1.6}</style></head><body><div class='card'>"
    "<h2>WiFi portal requested.</h2><p>The device is switching into setup mode now. Connect to the CHEETAH_HUNTER_SETUP network if prompted.</p>"
    "</div></body></html>");
}

void handleClearPopup() {
  clearBlockPopup();
  server.sendHeader("Location", "/", true);
  server.send(303, "text/plain", "");
}

void handleStatusJson() {
  syncFiatAvailability();
  walletFiatValue = currentWalletFiatValue();
  String currencyCode = currentCurrencyCode();
  String json = "{";
  json += "\"ip\":\"" + currentIpText() + "\",";
  json += "\"status\":\"" + statusText + "\",";
  json += "\"currency\":\"" + currencyCode + "\",";
  json += "\"currency_name\":\"" + currencyDisplayName(currencyCode) + "\",";
  json += "\"balance_chta\":" + String(balanceCHTA, 8) + ",";
  json += "\"chta_usd\":" + String(chtaPriceUsd, 8) + ",";
  json += "\"chta_gbp\":" + String(chtaPriceGbp, 8) + ",";
  json += "\"chta_cad\":" + String(chtaPriceCad, 8) + ",";
  json += "\"chta_fiat\":" + String(currentChtaFiatPrice(), 8) + ",";
  json += "\"chta_raw_fiat\":" + String(currentRawChtaFiatPrice(), 8) + ",";
  json += "\"price_source\":\"gleec_wallet_tickers_v2_or_coinpaprika\",";
  json += "\"wallet_fiat\":" + String(walletFiatValue, 8) + ",";
  json += "\"wallet_usd\":" + String(balanceCHTA * chtaPriceUsd, 8) + ",";
  json += "\"wallet_configured\":" + String(cfgWallet.isEmpty() ? "false" : "true") + ",";
  json += "\"have_wallet_data\":" + String(haveWalletData ? "true" : "false") + ",";
  json += "\"have_fiat_data\":" + String(haveFiatData ? "true" : "false") + ",";
  json += "\"flip\":" + String(cfgFlip ? "true" : "false");
  json += "}";
  server.send(200, "application/json", json);
}

void setupWebServer() {
  server.on("/", HTTP_GET, handleRoot);
  server.on("/save", HTTP_POST, handleSave);
  server.on("/clear-popup", HTTP_POST, handleClearPopup);
  server.on("/wifi", HTTP_POST, handleOpenWifiPortal);
  server.on("/status", HTTP_GET, handleStatusJson);
  server.begin();
}

void runWifiManagerPortal() {
  WiFiManager wm;
  portalMode = true;
  drawStaticLayout();
  statusText = "CONNECT TO CHEETAH_HUNTER_SETUP WIFI";
  drawValues();
  wm.setConfigPortalTimeout(180);
  bool connected = wm.autoConnect(AP_SSID, AP_PASS);

  if (!connected) {
    statusText = "WIFI PORTAL TIMEOUT";
    drawValues();
    return;
  }

  portalMode = false;
  statusText = cfgWallet.isEmpty() ? "NO WALLET CONFIG" : "LIVE " + WiFi.localIP().toString();
  drawValues();
}

void setup() {
  pinMode(TFT_BL, OUTPUT);
  digitalWrite(TFT_BL, HIGH);

  pinMode(REAR_LED, OUTPUT);
  rearLedOn();

  tft.init();
  loadPrefs();
  applyRotation();
  tft.setTextDatum(top_left);
  tft.fillScreen(C_BG);

  drawStaticLayout();
  statusText = "STARTING WIFI...";
  drawValues();

  if (WiFi.status() != WL_CONNECTED) {
    runWifiManagerPortal();
  }

  setupWebServer();

  if (WiFi.status() == WL_CONNECTED) {
    refreshWalletOnly();
    refreshFiatOnly();
    checkForMinedBlockAlert();
  }

  drawStaticLayout();
  drawValues();

  if (isBlockPopupVisible()) drawBlockPopup();

  lastWalletFetch = millis();
  lastFiatFetch = millis();
  lastMinedAlertCheck = millis();
}

void loop() {
  rearLedOn();
  server.handleClient();

  if (portalMode) {
    runWifiManagerPortal();
    drawStaticLayout();
    drawValues();
  }

  if (WiFi.status() != WL_CONNECTED) {
    delay(100);
    return;
  }

  // POPUP LOCK: freeze background updates while popup is active
  if (popupActive) {
    if (!isBlockPopupVisible()) {
      clearBlockPopup();
    } else {
      // do nothing except keep LED alive
      delay(20);
      return;
    }
  }

  if (millis() - lastWalletFetch >= WALLET_REFRESH_MS) {
    lastWalletFetch = millis();
    refreshWalletOnly();
    drawValues();
  }

  if (millis() - lastFiatFetch >= FIAT_REFRESH_MS) {
    lastFiatFetch = millis();
    refreshFiatOnly();
    drawValues();
  }

  if (millis() - lastMinedAlertCheck >= MINED_ALERT_REFRESH_MS) {
    lastMinedAlertCheck = millis();
    checkForMinedBlockAlert();
    if (isBlockPopupVisible()) drawBlockPopup();
  }

  delay(20);
}
